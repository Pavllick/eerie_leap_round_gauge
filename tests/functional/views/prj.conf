## CMakeLists.txt
```
cmake_minimum_required(VERSION 3.20.0)

set(RT_GAUGE_TEST_SIM_FLASH ON)
set(RT_GAUGE_TEST_LVGL ON)
include(${CMAKE_CURRENT_SOURCE_DIR}/../../rt_gauge_test.cmake)

# Use Zephyr's build system
find_package(Zephyr REQUIRED HINTS $ENV{ZEPHYR_BASE})
project(functional_views)

include_directories(${APP_SRC_DIR})

set(APP_SRC_CONFIGURATION_DIR ${APP_SRC_DIR}/configuration)
file(GLOB_RECURSE APP_SRC_CONFIGURATION
  ${APP_SRC_CONFIGURATION_DIR}/*.c
  ${APP_SRC_CONFIGURATION_DIR}/*.cpp
)

set(APP_SRC_UI_DOMAIN_DIR ${APP_SRC_DIR}/domain/ui_domain)
file(GLOB_RECURSE APP_SRC_UI_DOMAIN
  ${APP_SRC_UI_DOMAIN_DIR}/*.c
  ${APP_SRC_UI_DOMAIN_DIR}/*.cpp
)

# WidgetBase resolves its bindings through EventChannelRegistry.
set(APP_SRC_EVENT_BUS_DIR ${APP_SRC_DIR}/event_bus)
file(GLOB_RECURSE APP_SRC_EVENT_BUS
  ${APP_SRC_EVENT_BUS_DIR}/*.c
  ${APP_SRC_EVENT_BUS_DIR}/*.cpp
)

set(APP_SRC_VIEWS_DIR ${APP_SRC_DIR}/views)
file(GLOB_RECURSE APP_SRC_VIEWS
  ${APP_SRC_VIEWS_DIR}/*.c
  ${APP_SRC_VIEWS_DIR}/*.cpp
)

# The bundled images are ~430 KB of pixel data each and nothing under views/
# references them; the fonts are needed by the themes.
list(FILTER APP_SRC_VIEWS EXCLUDE REGEX "/views/assets/images/")

file(GLOB_RECURSE TEST_SOURCES src/*.c src/*.cpp)

# Add all source files to the app target
target_sources(app PRIVATE
  ${APP_SRC_CONFIGURATION}
  ${APP_SRC_EVENT_BUS}
  ${APP_SRC_UI_DOMAIN}
  ${APP_SRC_VIEWS}
  ${TEST_SOURCES}
)
```

## Kconfig
```
menu "Zephyr"
source "Kconfig.zephyr"
endmenu

config EERIE_LEAP_HW_VERSION_MAJOR
	int "Hardware version major"
	range 0 255
	default 0

config EERIE_LEAP_HW_VERSION_MINOR
	int "Hardware version minor"
	range 0 255
	default 0

config EERIE_LEAP_HW_VERSION_PATCH
	int "Hardware version patch"
	range 0 65535
	default 0

config EERIE_LEAP_SW_VERSION_MAJOR
	int "Software version major"
	range 0 255
	default 0

config EERIE_LEAP_SW_VERSION_MINOR
	int "Software version minor"
	range 0 255
	default 0

config EERIE_LEAP_SW_VERSION_PATCH
	int "Software version patch"
	range 0 65535
	default 0

config EERIE_LEAP_UI_RENDERER_THREAD_STACK_SIZE
	int "UI renderer thread stack size"
	default 8192

config EERIE_LEAP_FLOAT_SIGNIFICANT_DIGITS
	int "Floating point significant digits"
	default 4

config EERIE_LEAP_FS_SD_THREAD_STACK_SIZE
	int "SD thread stack size"
	default 2048

config EERIE_LEAP_SD_CHECK_INTERVAL_MS
	int "SD check interval ms"
	default 1000
```

## prj.conf
```kconfig
CONFIG_ZTEST=y

#HW Version
CONFIG_EERIE_LEAP_HW_VERSION_MAJOR=2
CONFIG_EERIE_LEAP_HW_VERSION_MINOR=9
CONFIG_EERIE_LEAP_HW_VERSION_PATCH=6

#SW Version
CONFIG_EERIE_LEAP_SW_VERSION_MAJOR=7
CONFIG_EERIE_LEAP_SW_VERSION_MINOR=8
CONFIG_EERIE_LEAP_SW_VERSION_PATCH=4

# Language and Compiler
CONFIG_CPP=y
CONFIG_PICOLIBC=y
CONFIG_STD_CPP23=y
CONFIG_REQUIRES_FULL_LIBCPP=y
CONFIG_CPP_EXCEPTIONS=y
CONFIG_CPP_RTTI=y

# Memory
CONFIG_HEAP_MEM_POOL_SIZE=32768

# C++ exception unwinding needs considerably more stack than the ztest defaults.
CONFIG_MAIN_STACK_SIZE=8192
CONFIG_ZTEST_STACK_SIZE=8192

# Logging And Debugging
CONFIG_LOG=y
CONFIG_TEST_RANDOM_GENERATOR=y
CONFIG_THREAD_ANALYZER=y
CONFIG_THREAD_ANALYZER_USE_LOG=y
CONFIG_THREAD_RUNTIME_STATS=y
CONFIG_THREAD_NAME=y
CONFIG_SYS_HEAP_RUNTIME_STATS=y
CONFIG_THREAD_ANALYZER_ISR_STACK_USAGE=n

# FS Config
CONFIG_FLASH=y
CONFIG_FLASH_MAP=y
CONFIG_FILE_SYSTEM=y
CONFIG_FILE_SYSTEM_LITTLEFS=y
CONFIG_FILE_SYSTEM_MKFS=y

# CBOR
CONFIG_ZCBOR=y

# LVGL
CONFIG_LVGL=y
CONFIG_LV_Z_MEM_POOL_SIZE=131072
CONFIG_LV_USE_LOG=n
CONFIG_LV_USE_LABEL=y
CONFIG_LV_USE_IMAGE=y
CONFIG_LV_USE_FONT_COMPRESSED=y
CONFIG_LV_FONT_MONTSERRAT_20=y
CONFIG_LV_FONT_DEFAULT_UNSCII_16=y

CONFIG_CRC=y
CONFIG_TIMING_FUNCTIONS=y

CONFIG_EERIE_LEAP_RT_CORE=y
CONFIG_EERIE_LEAP_ASSETS=y
CONFIG_EERIE_LEAP_CONFIGURATION=y
CONFIG_EERIE_LEAP_DEVICE_TREE=y
CONFIG_EERIE_LEAP_EVENT_BUS=y
CONFIG_EERIE_LEAP_FS=y
CONFIG_EERIE_LEAP_RANDOM=y
CONFIG_EERIE_LEAP_TIME=y
CONFIG_EERIE_LEAP_LUA_SCRIPT=y
CONFIG_EERIE_LEAP_MATH_PARSER=y
```

## src/button_control.cpp
```c
#include <cstdint>
#include <memory>
#include <vector>

#include <zephyr/kernel.h>
#include <zephyr/ztest.h>

#include <lvgl.h>

#include <eerie_memory.hpp>

#include "subsys/event_bus/event_bus.h"
#include "subsys/event_bus/event_channel.h"

#include "utilities/memory/memory_resource_manager.h"

#include "domain/ui_domain/event_bus/navigation_event_channel.h"
#include "domain/ui_domain/models/navigation_intent.h"
#include "domain/ui_domain/models/widget_configuration.h"
#include "domain/ui_domain/models/widget_property.h"
#include "domain/ui_domain/models/widget_type.h"
#include "domain/ui_domain/services/navigation_service.h"

#include "views/utilitites/frame.h"
#include "views/widgets/controls/button_control/button_control.h"
#include "views/widgets/widget_context.h"

#include "views_test_support.h"

using namespace eerie_memory;

using eerie_leap::domain::ui_domain::event_bus::NavigationEventChannel;
using eerie_leap::domain::ui_domain::event_bus::NavigationEventType;
using eerie_leap::domain::ui_domain::event_bus::NavigationPayloadType;
using eerie_leap::domain::ui_domain::models::NavigationAction;
using eerie_leap::domain::ui_domain::models::NavigationIntent;
using eerie_leap::domain::ui_domain::models::WidgetConfiguration;
using eerie_leap::domain::ui_domain::models::WidgetProperty;
using eerie_leap::domain::ui_domain::models::WidgetPropertyType;
using eerie_leap::domain::ui_domain::models::WidgetType;
using eerie_leap::domain::ui_domain::services::NavigationService;
using eerie_leap::subsys::event_bus::AnySubscription;
using eerie_leap::subsys::event_bus::CreateScopedSubscription;
using eerie_leap::subsys::event_bus::EventBus;
using eerie_leap::utilities::memory::Mrm;
using eerie_leap::views::utilitites::Frame;
using eerie_leap::views::widgets::WidgetContext;
using eerie_leap::views::widgets::controls::ButtonControl;
using views_test::CleanTestDisplay;
using views_test::EnsureTestDisplay;

namespace {

constexpr int DISPATCH_TIMEOUT_MS = 1000;
constexpr int NO_DISPATCH_TIMEOUT_MS = 200;
constexpr int BUS_STACK_SIZE = 4096;

// NavigationEventChannel is inert until a bus drains it.
class ButtonBus : public EventBus {
public:
    ButtonBus() : EventBus("button_test_bus", BUS_STACK_SIZE) {
        RegisterChannel(NavigationEventChannel::GetInstance());
    }
};

class NavigationProbe {
public:
    NavigationProbe() {
        k_sem_init(&delivered_, 0, K_SEM_MAX_LIMIT);

        subscription_ = CreateScopedSubscription(
            NavigationEventChannel::GetInstance(),
            NavigationEventType::Changed,
            [this](const NavigationEventChannel::EventMessage& event) { Record(event); });
    }

    NavigationProbe(const NavigationProbe&) = delete;
    NavigationProbe& operator=(const NavigationProbe&) = delete;

    bool WaitForEvent(int timeout_ms = DISPATCH_TIMEOUT_MS) {
        return k_sem_take(&delivered_, K_MSEC(timeout_ms)) == 0;
    }

    [[nodiscard]] const std::vector<NavigationAction>& Actions() const { return actions_; }
    [[nodiscard]] const std::vector<uint32_t>& TargetGroupIds() const { return target_group_ids_; }
    [[nodiscard]] const std::vector<uint32_t>& TargetScreenIds() const { return target_screen_ids_; }

private:
    k_sem delivered_{};
    std::vector<NavigationAction> actions_;
    std::vector<uint32_t> target_group_ids_;
    std::vector<uint32_t> target_screen_ids_;

    // Declared last so it unsubscribes before the members a dispatch would touch.
    AnySubscription subscription_;

    void Record(const NavigationEventChannel::EventMessage& event) {
        if(auto it = event.payload.find(NavigationPayloadType::Action); it != event.payload.end())
            if(const auto* action = std::get_if<uint32_t>(&it->second))
                actions_.push_back(static_cast<NavigationAction>(*action));

        if(auto it = event.payload.find(NavigationPayloadType::TargetGroupId); it != event.payload.end())
            if(const auto* screen_group_id = std::get_if<uint32_t>(&it->second))
                target_group_ids_.push_back(*screen_group_id);

        if(auto it = event.payload.find(NavigationPayloadType::TargetScreenId); it != event.payload.end())
            if(const auto* screen_id = std::get_if<uint32_t>(&it->second))
                target_screen_ids_.push_back(*screen_id);

        k_sem_give(&delivered_);
    }
};

std::shared_ptr<Frame> MakeRoot() {
    return std::make_shared<Frame>(Frame::CreateWrapped()
        .SetWidth(200, false)
        .SetHeight(200, false)
        .Build());
}

// A button renders its lv_button into the container the widget creates under the
// parent, so the clickable object is the first grandchild of the root.
lv_obj_t* FindButton(const std::shared_ptr<Frame>& root) {
    lv_obj_t* container = lv_obj_get_child(root->GetObject(), 0);
    zassert_not_null(container, "Expected the widget to create a container.");

    lv_obj_t* button = lv_obj_get_child(container, 0);
    zassert_not_null(button, "Expected the widget to create a button.");

    return button;
}

std::shared_ptr<WidgetConfiguration> MakeConfiguration() {
    auto configuration = make_shared_pmr<WidgetConfiguration>(Mrm::GetDefaultPmr());
    configuration->type = WidgetType::ControlButton;
    configuration->id = 0;
    configuration->position_grid.x = 0;
    configuration->position_grid.y = 0;
    configuration->size_grid.width = 100;
    configuration->size_grid.height = 40;
    configuration->properties[WidgetProperty::GetTypeName(WidgetPropertyType::LABEL)] = "Go";

    return configuration;
}

// Builds a rendered button bound to `navigation_service` and clicks it.
void Click(
    const std::shared_ptr<NavigationService>& navigation_service,
    const std::shared_ptr<WidgetConfiguration>& configuration) {

    auto root = MakeRoot();
    ButtonControl button(0, root, WidgetContext { .navigation_service = navigation_service });

    button.Configure(configuration);
    zassert_equal(button.Render(), 0, "Expected the button to render.");

    lv_obj_send_event(FindButton(root), LV_EVENT_CLICKED, nullptr);
}

void* StartEventBus() {
    static ButtonBus bus;

    return nullptr;
}

// Let anything the previous test published drain while no probe is subscribed.
void SettleEventBus(void* fixture) {
    k_msleep(20);
    CleanTestDisplay(fixture);
}

} // namespace

ZTEST_SUITE(button_control, NULL, StartEventBus, NULL, SettleEventBus, NULL);

ZTEST(button_control, test_a_button_with_only_a_target_group_still_switches_groups) {
    EnsureTestDisplay();

    auto navigation_service = std::make_shared<NavigationService>();
    navigation_service->SetGroupIds({ 0, 1 });
    navigation_service->SetActiveGroupId(0);

    NavigationProbe probe;

    auto configuration = MakeConfiguration();
    configuration->properties[WidgetProperty::GetTypeName(WidgetPropertyType::TARGET_SCREEN_GROUP)] = 1;

    Click(navigation_service, configuration);

    zassert_true(probe.WaitForEvent(), "Expected the click to publish a navigation change.");
    zassert_equal(probe.Actions().size(), 1);
    zassert_equal(probe.Actions().front(), NavigationAction::ShowGroup);
    zassert_equal(probe.TargetGroupIds().front(), 1);
}

ZTEST(button_control, test_a_button_can_show_a_target_screen_as_an_overlay) {
    EnsureTestDisplay();

    auto navigation_service = std::make_shared<NavigationService>();
    navigation_service->SetGroupIds({ 0 });
    navigation_service->SetActiveGroupId(0);

    NavigationProbe probe;

    auto configuration = MakeConfiguration();
    configuration->properties[WidgetProperty::GetTypeName(WidgetPropertyType::NAVIGATION_INTENT)] =
        static_cast<int>(NavigationIntent::ShowOverlay);
    configuration->properties[WidgetProperty::GetTypeName(WidgetPropertyType::TARGET_SCREEN_GROUP)] = 7;

    Click(navigation_service, configuration);

    zassert_true(probe.WaitForEvent(), "Expected the click to publish a navigation change.");
    zassert_equal(probe.Actions().front(), NavigationAction::ShowOverlay);
    zassert_equal(probe.TargetScreenIds().front(), 7);
    zassert_true(navigation_service->IsOverlayActive());
}

ZTEST(button_control, test_a_button_can_close_the_active_overlay) {
    EnsureTestDisplay();

    auto navigation_service = std::make_shared<NavigationService>();
    navigation_service->SetGroupIds({ 0 });
    navigation_service->SetActiveGroupId(0);

    NavigationProbe probe;

    // The probe is subscribed first so this setup event is accounted for rather than
    // arriving later and being mistaken for the button's.
    zassert_equal(navigation_service->ShowOverlay(7), 0);
    zassert_true(probe.WaitForEvent(), "Expected the overlay to open.");

    auto configuration = MakeConfiguration();
    configuration->properties[WidgetProperty::GetTypeName(WidgetPropertyType::NAVIGATION_INTENT)] =
        static_cast<int>(NavigationIntent::CloseOverlay);

    Click(navigation_service, configuration);

    zassert_true(probe.WaitForEvent(), "Expected the click to publish a navigation change.");
    zassert_equal(probe.Actions().back(), NavigationAction::CloseOverlay);
    zassert_false(navigation_service->IsOverlayActive());
}

// An intent that needs a target but has none must do nothing rather than act on 0.
ZTEST(button_control, test_a_show_overlay_button_without_a_target_does_nothing) {
    EnsureTestDisplay();

    auto navigation_service = std::make_shared<NavigationService>();
    navigation_service->SetGroupIds({ 0 });
    navigation_service->SetActiveGroupId(0);

    NavigationProbe probe;

    auto configuration = MakeConfiguration();
    configuration->properties[WidgetProperty::GetTypeName(WidgetPropertyType::NAVIGATION_INTENT)] =
        static_cast<int>(NavigationIntent::ShowOverlay);

    Click(navigation_service, configuration);

    zassert_false(probe.WaitForEvent(NO_DISPATCH_TIMEOUT_MS), "Expected no navigation change.");
    zassert_false(navigation_service->IsOverlayActive());
}

ZTEST(button_control, test_a_button_without_any_navigation_property_does_nothing) {
    EnsureTestDisplay();

    auto navigation_service = std::make_shared<NavigationService>();
    navigation_service->SetGroupIds({ 0, 1 });
    navigation_service->SetActiveGroupId(0);

    NavigationProbe probe;

    Click(navigation_service, MakeConfiguration());

    zassert_false(probe.WaitForEvent(NO_DISPATCH_TIMEOUT_MS), "Expected no navigation change.");
}

// Next needs no target, so it must dispatch on the intent alone.
ZTEST(button_control, test_a_button_can_carry_an_intent_that_needs_no_target) {
    EnsureTestDisplay();

    auto navigation_service = std::make_shared<NavigationService>();
    navigation_service->SetGroupIds({ 0, 1 });
    navigation_service->SetActiveGroupId(0);

    NavigationProbe probe;

    auto configuration = MakeConfiguration();
    configuration->properties[WidgetProperty::GetTypeName(WidgetPropertyType::NAVIGATION_INTENT)] =
        static_cast<int>(NavigationIntent::NextGroup);

    Click(navigation_service, configuration);

    zassert_true(probe.WaitForEvent(), "Expected the click to publish a navigation change.");
    zassert_equal(probe.Actions().front(), NavigationAction::ShowGroup);
    zassert_equal(probe.TargetGroupIds().front(), 1);
}
```

## src/main_view.cpp
```c
#include <cerrno>
#include <functional>
#include <memory>
#include <vector>

#include <zephyr/ztest.h>
#include <lvgl.h>

#include "views/main_view.h"

#include "views_test_support.h"

using eerie_leap::views::MainView;
using eerie_leap::views::utilitites::Frame;
using views_test::CleanTestDisplay;
using views_test::EnsureTestDisplay;
using views_test::FakeScreen;

namespace {

// The dispatcher stands in for the UI render work queue: the work is collected
// here so a test can decide exactly when - and in which order - it runs.
class DeferredRenderQueue {
private:
    std::vector<std::function<void()>> work_;

public:
    MainView::RenderDispatcher GetDispatcher() {
        return [this](std::function<void()> work) { work_.push_back(std::move(work)); };
    }

    size_t Pending() const {
        return work_.size();
    }

    void RunAll() {
        auto work = std::move(work_);
        work_.clear();

        for(auto& item : work)
            item();
    }
};

std::shared_ptr<FakeScreen> AddScreen(MainView& view, uint32_t id, uint32_t screen_group_id) {
    auto screen = std::make_shared<FakeScreen>(id, screen_group_id, 0, true, view.GetGroupContainer(screen_group_id));
    view.AddScreen(screen);

    return screen;
}

bool IsGroupHidden(MainView& view, uint32_t screen_group_id) {
    return lv_obj_has_flag(view.GetGroupContainer(screen_group_id)->GetObject(), LV_OBJ_FLAG_HIDDEN);
}

void* SetUp() {
    EnsureTestDisplay();

    return nullptr;
}

} // namespace

ZTEST_SUITE(main_view, NULL, SetUp, NULL, CleanTestDisplay, NULL);

ZTEST(main_view, test_an_unknown_group_is_rejected) {
    MainView view;

    zassert_equal(view.SetActiveGroup(3), -ENOENT);
    zassert_false(view.GetActiveGroupId().has_value());
}

// Configure() runs before Start(), so the selection has to survive until the
// view itself is rendered.
ZTEST(main_view, test_a_selection_made_before_rendering_is_only_recorded) {
    MainView view;

    auto screen = AddScreen(view, 0, 0);

    zassert_equal(view.SetActiveGroup(0), 0);
    zassert_equal(view.GetActiveGroupId().value(), 0);
    zassert_equal(screen->render_count, 0);

    zassert_equal(view.Render(), 0);

    zassert_equal(screen->render_count, 1);
    zassert_equal(screen->activated_count, 1);
}

ZTEST(main_view, test_only_the_active_group_is_rendered) {
    MainView view;

    auto first = AddScreen(view, 0, 0);
    auto second = AddScreen(view, 1, 1);

    zassert_equal(view.SetActiveGroup(0), 0);
    zassert_equal(view.Render(), 0);

    zassert_equal(first->render_count, 1);
    zassert_equal(second->render_count, 0);
}

ZTEST(main_view, test_without_a_dispatcher_the_switch_renders_inline) {
    MainView view;

    auto first = AddScreen(view, 0, 0);
    auto second = AddScreen(view, 1, 1);

    zassert_equal(view.SetActiveGroup(0), 0);
    zassert_equal(view.Render(), 0);

    zassert_equal(view.SetActiveGroup(1), 0);

    zassert_equal(second->render_count, 1);
    zassert_equal(second->activated_count, 1);
    zassert_equal(first->deactivated_count, 1);
    zassert_equal(view.GetActiveGroupId().value(), 1);
}

ZTEST(main_view, test_reselecting_the_active_group_is_a_no_op) {
    MainView view;

    auto screen = AddScreen(view, 0, 0);

    zassert_equal(view.SetActiveGroup(0), 0);
    zassert_equal(view.Render(), 0);
    zassert_equal(view.SetActiveGroup(0), 0);

    zassert_equal(screen->render_count, 1);
    zassert_equal(screen->activated_count, 1);
    zassert_equal(screen->deactivated_count, 0);
}

// The first render of a group builds its whole LVGL tree; doing that on the
// event bus thread would block the renderer through the LVGL lock.
ZTEST(main_view, test_with_a_dispatcher_the_first_render_is_deferred) {
    MainView view;
    DeferredRenderQueue queue;

    auto first = AddScreen(view, 0, 0);
    auto second = AddScreen(view, 1, 1);

    zassert_equal(view.SetActiveGroup(0), 0);
    zassert_equal(view.Render(), 0);

    view.SetRenderDispatcher(queue.GetDispatcher());

    zassert_equal(view.SetActiveGroup(1), 0);

    // The switch is already committed even though nothing has been built yet.
    zassert_equal(view.GetActiveGroupId().value(), 1);
    zassert_equal(first->deactivated_count, 1);
    zassert_equal(second->render_count, 0);
    zassert_equal(queue.Pending(), 1);

    queue.RunAll();

    zassert_equal(second->render_count, 1);
    zassert_equal(second->activated_count, 1);
}

ZTEST(main_view, test_an_already_rendered_group_does_not_queue_work) {
    MainView view;
    DeferredRenderQueue queue;

    auto first = AddScreen(view, 0, 0);
    auto second = AddScreen(view, 1, 1);

    zassert_equal(view.SetActiveGroup(0), 0);
    zassert_equal(view.Render(), 0);

    view.SetRenderDispatcher(queue.GetDispatcher());

    zassert_equal(view.SetActiveGroup(1), 0);
    queue.RunAll();

    zassert_equal(view.SetActiveGroup(0), 0);
    zassert_equal(queue.Pending(), 0);
    zassert_equal(first->activated_count, 2);
    zassert_equal(first->render_count, 1);
}

// Two swipes before either render completes: the stale one must not resurface.
ZTEST(main_view, test_back_to_back_switches_leave_only_the_last_group_visible) {
    MainView view;
    DeferredRenderQueue queue;

    auto first = AddScreen(view, 0, 0);
    auto second = AddScreen(view, 1, 1);
    auto third = AddScreen(view, 2, 2);

    zassert_equal(view.SetActiveGroup(0), 0);
    zassert_equal(view.Render(), 0);

    view.SetRenderDispatcher(queue.GetDispatcher());

    zassert_equal(view.SetActiveGroup(1), 0);
    zassert_equal(view.SetActiveGroup(2), 0);
    zassert_equal(queue.Pending(), 2);

    queue.RunAll();

    zassert_equal(view.GetActiveGroupId().value(), 2);
    zassert_equal(second->render_count, 1);
    zassert_equal(second->activated_count, 0);
    zassert_equal(third->activated_count, 1);
    zassert_true(IsGroupHidden(view, 1));
    zassert_false(IsGroupHidden(view, 2));
}

ZTEST(main_view, test_empty_groups_are_pruned) {
    MainView view;

    AddScreen(view, 0, 0);

    // A screen that fails to configure still leaves its group behind.
    view.GetGroupContainer(9);

    zassert_equal(view.GetGroupIds().size(), 2);

    view.PruneEmptyGroups();

    auto screen_group_ids = view.GetGroupIds();
    zassert_equal(screen_group_ids.size(), 1);
    zassert_equal(screen_group_ids[0], 0);
}

ZTEST(main_view, test_group_ids_are_sorted) {
    MainView view;

    AddScreen(view, 0, 7);
    AddScreen(view, 1, 2);
    AddScreen(view, 2, 5);

    auto screen_group_ids = view.GetGroupIds();

    zassert_equal(screen_group_ids.size(), 3);
    zassert_equal(screen_group_ids[0], 2);
    zassert_equal(screen_group_ids[1], 5);
    zassert_equal(screen_group_ids[2], 7);
}

ZTEST(main_view, test_screens_are_found_across_groups) {
    MainView view;

    auto first = AddScreen(view, 4, 0);
    auto second = AddScreen(view, 5, 1);

    zassert_equal(view.GetScreen(4).get(), first.get());
    zassert_equal(view.GetScreen(5).get(), second.get());
    zassert_is_null(view.GetScreen(6).get());
}

ZTEST(main_view, test_a_failed_inline_render_rolls_back_to_the_previous_group) {
    MainView view;

    auto first = AddScreen(view, 0, 0);
    auto second = AddScreen(view, 1, 1);
    second->FailNextRenders();

    zassert_equal(view.SetActiveGroup(0), 0);
    zassert_equal(view.Render(), 0);

    zassert_not_equal(view.SetActiveGroup(1), 0);

    zassert_equal(view.GetActiveGroupId().value(), 0);
    zassert_equal(first->activated_count, 2);
    zassert_false(IsGroupHidden(view, 0));
    zassert_true(IsGroupHidden(view, 1));
}

// The deferred switch is already committed when the render runs, so the failure
// has to be undone afterwards or the screen stays blank.
ZTEST(main_view, test_a_failed_deferred_render_rolls_back_to_the_previous_group) {
    MainView view;
    DeferredRenderQueue queue;

    auto first = AddScreen(view, 0, 0);
    auto second = AddScreen(view, 1, 1);
    second->FailNextRenders();

    zassert_equal(view.SetActiveGroup(0), 0);
    zassert_equal(view.Render(), 0);

    view.SetRenderDispatcher(queue.GetDispatcher());

    zassert_equal(view.SetActiveGroup(1), 0);
    zassert_equal(view.GetActiveGroupId().value(), 1);

    queue.RunAll();

    zassert_equal(view.GetActiveGroupId().value(), 0);
    zassert_equal(first->activated_count, 2);
    zassert_false(IsGroupHidden(view, 0));
    zassert_true(IsGroupHidden(view, 1));
}

// A second switch queued behind the failing one already owns the active state.
ZTEST(main_view, test_a_failed_deferred_render_does_not_undo_a_later_switch) {
    MainView view;
    DeferredRenderQueue queue;

    auto first = AddScreen(view, 0, 0);
    auto second = AddScreen(view, 1, 1);
    auto third = AddScreen(view, 2, 2);
    second->FailNextRenders();

    zassert_equal(view.SetActiveGroup(0), 0);
    zassert_equal(view.Render(), 0);

    view.SetRenderDispatcher(queue.GetDispatcher());

    zassert_equal(view.SetActiveGroup(1), 0);
    zassert_equal(view.SetActiveGroup(2), 0);

    queue.RunAll();

    zassert_equal(view.GetActiveGroupId().value(), 2);
    zassert_equal(third->render_count, 1);
    zassert_false(IsGroupHidden(view, 2));
    zassert_true(IsGroupHidden(view, 0));
    zassert_true(IsGroupHidden(view, 1));
}
```

## src/overlay_host.cpp
```c
#include <cerrno>
#include <cstdint>
#include <memory>
#include <stdexcept>

#include <zephyr/ztest.h>
#include <lvgl.h>

#include "domain/ui_domain/services/navigation_service.h"

#include "views/overlay_host.h"
#include "views/screens/screen_group.h"
#include "views/utilitites/frame.h"

#include "views_test_support.h"

using eerie_leap::domain::ui_domain::services::NavigationService;
using eerie_leap::views::OverlayHost;
using eerie_leap::views::OverlayOptions;
using eerie_leap::views::screens::ScreenGroup;
using eerie_leap::views::utilitites::Frame;
using views_test::CleanTestDisplay;
using views_test::EnsureTestDisplay;
using views_test::FakeScreen;

namespace {

constexpr uint32_t overlay_screen_id = 7;

// Pop() destroys the group and every screen in it, so a test that asserts on a
// dismissed overlay has to outlive the screen with its own counter.
class CountingScreen : public FakeScreen {
private:
    std::shared_ptr<int> deactivations_;

public:
    CountingScreen(uint32_t id, std::shared_ptr<Frame> parent, std::shared_ptr<int> deactivations)
        : FakeScreen(id, id, 0, true, std::move(parent)), deactivations_(std::move(deactivations)) {}

    void OnDeactivated() override {
        FakeScreen::OnDeactivated();

        (*deactivations_)++;
    }
};

// Activation reaches widget code, which can throw - a failed push still has to
// leave the host and the top layer as it found them.
class ThrowingScreen : public FakeScreen {
public:
    using FakeScreen::FakeScreen;

    void OnActivated() override {
        FakeScreen::OnActivated();

        throw std::runtime_error("activation failed");
    }
};

// The scrim and the auto-close timer both close through NavigationService, whose
// overlay state is what a test can observe without a running event bus.
std::shared_ptr<NavigationService> MakeNavigationWithOverlay() {
    auto navigation_service = std::make_shared<NavigationService>();
    navigation_service->ShowOverlay(overlay_screen_id);

    return navigation_service;
}

std::shared_ptr<OverlayHost> MakeHost(std::shared_ptr<NavigationService> navigation_service = nullptr) {
    return std::make_shared<OverlayHost>(std::move(navigation_service));
}

struct Overlay {
    std::unique_ptr<ScreenGroup> screen_group;
    std::shared_ptr<FakeScreen> screen;
    std::shared_ptr<int> deactivations;
};

// A screen is never rendered on its own, so every overlay is a group of one here.
Overlay MakeOverlay(const std::shared_ptr<OverlayHost>& host, uint32_t id) {
    auto deactivations = std::make_shared<int>(0);
    auto screen_group = host->CreateGroup(id);
    auto screen = std::make_shared<CountingScreen>(id, screen_group->GetContainer(), deactivations);

    screen_group->AddScreen(screen);

    return Overlay { std::move(screen_group), std::move(screen), std::move(deactivations) };
}

int PushOverlay(
    const std::shared_ptr<OverlayHost>& host,
    uint32_t id,
    const OverlayOptions& options = {}) {

    auto overlay = MakeOverlay(host, id);

    return host->Push(std::move(overlay.screen_group), options);
}

bool IsHidden(const std::shared_ptr<OverlayHost>& host) {
    return lv_obj_has_flag(host->GetContainer()->GetObject(), LV_OBJ_FLAG_HIDDEN);
}

uint32_t ChildCount(const std::shared_ptr<OverlayHost>& host) {
    return lv_obj_get_child_count(host->GetContainer()->GetObject());
}

// LVGL only runs timers from lv_timer_handler(), and only once their period has
// elapsed. The suites do not run Zephyr's LVGL init, so the tick may still be
// LVGL's own counter rather than k_uptime_get_32(); advance both.
void RunTimersFor(uint32_t duration_ms) {
    k_msleep(duration_ms);
    lv_tick_inc(duration_ms);
    lv_timer_handler();
}

void* SetUp() {
    EnsureTestDisplay();

    return nullptr;
}

} // namespace

ZTEST_SUITE(overlay_host, NULL, SetUp, NULL, CleanTestDisplay, NULL);

ZTEST(overlay_host, test_a_new_host_is_empty_and_hidden) {
    auto host = MakeHost();

    zassert_true(host->IsEmpty());
    zassert_equal(host->GetDepth(), 0);
    zassert_true(host->GetTopGroup() == nullptr);
    zassert_true(IsHidden(host));
}

// The host sits on the top layer so it paints above every screen group.
ZTEST(overlay_host, test_the_container_lives_on_the_top_layer) {
    auto host = MakeHost();

    zassert_equal(lv_obj_get_parent(host->GetContainer()->GetObject()), lv_layer_top());
}

// A full-screen clickable container would swallow the swipes navigation runs on,
// so blocking input has to be the scrim's job alone.
ZTEST(overlay_host, test_the_container_does_not_take_input) {
    auto host = MakeHost();

    zassert_false(lv_obj_has_flag(host->GetContainer()->GetObject(), LV_OBJ_FLAG_CLICKABLE));
}

ZTEST(overlay_host, test_push_renders_activates_and_shows) {
    auto host = MakeHost();
    auto overlay = MakeOverlay(host, 1);

    zassert_ok(host->Push(std::move(overlay.screen_group)));

    zassert_equal(overlay.screen->render_count, 1);
    zassert_equal(overlay.screen->activated_count, 1);
    zassert_equal(host->GetDepth(), 1);
    zassert_equal(host->GetTopGroup()->GetGroupId(), 1);
    zassert_false(IsHidden(host));
}

ZTEST(overlay_host, test_push_rejects_a_missing_group) {
    auto host = MakeHost();

    zassert_equal(host->Push(nullptr), -EINVAL);
    zassert_true(host->IsEmpty());
}

// A group with nothing in it would show as a bare scrim.
ZTEST(overlay_host, test_push_rejects_an_empty_group) {
    auto host = MakeHost();

    zassert_equal(host->Push(host->CreateGroup(1)), -EINVAL);
    zassert_true(host->IsEmpty());
}

ZTEST(overlay_host, test_push_refuses_to_stack_without_bound) {
    auto host = MakeHost();

    int pushed = 0;
    for(uint32_t id = 0; id < 16; id++) {
        if(PushOverlay(host, id) != 0)
            break;

        pushed++;
    }

    zassert_true(pushed > 0);
    zassert_equal(host->GetDepth(), static_cast<size_t>(pushed));
    zassert_equal(PushOverlay(host, 99), -ENOSPC);
}

// A modal overlay needs the scrim under it, not over it.
ZTEST(overlay_host, test_a_modal_push_puts_the_group_above_its_scrim) {
    auto host = MakeHost();

    zassert_ok(PushOverlay(host, 1, OverlayOptions { .is_modal = true }));

    zassert_equal(ChildCount(host), 2);

    auto* group_object = host->GetTopGroup()->GetContainer()->GetObject();
    zassert_equal(lv_obj_get_index(group_object), 1);

    auto* scrim = lv_obj_get_child(host->GetContainer()->GetObject(), 0);
    zassert_not_equal(scrim, group_object);
    zassert_true(lv_obj_has_flag(scrim, LV_OBJ_FLAG_CLICKABLE));
}

ZTEST(overlay_host, test_a_non_modal_push_has_no_scrim) {
    auto host = MakeHost();

    zassert_ok(PushOverlay(host, 1, OverlayOptions { .is_modal = false }));

    zassert_equal(ChildCount(host), 1);
}

ZTEST(overlay_host, test_a_failing_screen_leaves_the_host_empty) {
    auto host = MakeHost();
    auto overlay = MakeOverlay(host, 1);
    overlay.screen->FailNextRenders();

    zassert_not_equal(host->Push(std::move(overlay.screen_group)), 0);

    zassert_true(host->IsEmpty());
    zassert_true(IsHidden(host));
    zassert_equal(overlay.screen->activated_count, 0);
    zassert_equal(overlay.screen->deactivated_count, 0);

    // A screen holds the frame it was built on, which is the group's container.
    overlay.screen.reset();

    // The push was modal by default, so this also says the scrim was taken back.
    zassert_equal(ChildCount(host), 0);
}

ZTEST(overlay_host, test_a_screen_that_throws_while_activating_leaves_the_host_empty) {
    auto host = MakeHost();
    auto screen_group = host->CreateGroup(1);
    screen_group->AddScreen(std::make_shared<ThrowingScreen>(1, 1, 0, true, screen_group->GetContainer()));

    zassert_not_equal(host->Push(std::move(screen_group)), 0);

    zassert_true(host->IsEmpty());
    zassert_true(IsHidden(host));
    zassert_equal(ChildCount(host), 0);
}

ZTEST(overlay_host, test_pop_deactivates_and_hides) {
    auto host = MakeHost();
    auto overlay = MakeOverlay(host, 1);

    zassert_ok(host->Push(std::move(overlay.screen_group)));

    // The host owns the screen now; keeping it would outlive the objects Pop() frees.
    overlay.screen.reset();

    zassert_ok(host->Pop());

    zassert_equal(*overlay.deactivations, 1);
    zassert_true(host->IsEmpty());
    zassert_true(IsHidden(host));
    zassert_equal(ChildCount(host), 0);
}

ZTEST(overlay_host, test_pop_on_an_empty_host_is_reported) {
    auto host = MakeHost();

    zassert_equal(host->Pop(), -ENOENT);
}

ZTEST(overlay_host, test_pop_removes_only_the_top_overlay) {
    auto host = MakeHost();
    auto bottom = MakeOverlay(host, 1);
    auto top = MakeOverlay(host, 2);

    zassert_ok(host->Push(std::move(bottom.screen_group)));
    zassert_ok(host->Push(std::move(top.screen_group)));
    zassert_equal(host->GetTopGroup()->GetGroupId(), 2);

    bottom.screen.reset();
    top.screen.reset();

    zassert_ok(host->Pop());

    zassert_equal(host->GetDepth(), 1);
    zassert_equal(host->GetTopGroup()->GetGroupId(), 1);
    zassert_equal(*top.deactivations, 1);
    zassert_equal(*bottom.deactivations, 0);
    zassert_false(IsHidden(host));
}

ZTEST(overlay_host, test_dismiss_all_clears_the_stack) {
    auto host = MakeHost();
    auto first = MakeOverlay(host, 1);
    auto second = MakeOverlay(host, 2);

    zassert_ok(host->Push(std::move(first.screen_group)));
    zassert_ok(host->Push(std::move(second.screen_group)));

    first.screen.reset();
    second.screen.reset();

    host->DismissAll();

    zassert_true(host->IsEmpty());
    zassert_true(IsHidden(host));
    zassert_equal(*first.deactivations, 1);
    zassert_equal(*second.deactivations, 1);
    zassert_equal(ChildCount(host), 0);
}

// Nothing but the host holds the screen_group, so popping takes its objects with it.
ZTEST(overlay_host, test_pop_releases_the_overlays_objects) {
    auto host = MakeHost();

    zassert_ok(PushOverlay(host, 1));
    zassert_equal(ChildCount(host), 2);

    zassert_ok(host->Pop());

    zassert_equal(ChildCount(host), 0);
}

// Nothing else deletes the container, and the top layer outlives the host.
ZTEST(overlay_host, test_destruction_leaves_nothing_on_the_top_layer) {
    uint32_t before = lv_obj_get_child_count(lv_layer_top());

    {
        auto host = MakeHost();
        zassert_ok(PushOverlay(host, 1));
        zassert_equal(lv_obj_get_child_count(lv_layer_top()), before + 1);
    }

    zassert_equal(lv_obj_get_child_count(lv_layer_top()), before);
}

ZTEST(overlay_host, test_a_scrim_tap_closes_through_navigation) {
    auto navigation_service = MakeNavigationWithOverlay();
    auto host = MakeHost(navigation_service);

    zassert_ok(PushOverlay(host, 1));
    zassert_true(navigation_service->IsOverlayActive());

    lv_obj_send_event(lv_obj_get_child(host->GetContainer()->GetObject(), 0), LV_EVENT_CLICKED, nullptr);

    zassert_false(navigation_service->IsOverlayActive());

    // Closing is the navigation service's decision to route back as a Pop().
    zassert_equal(host->GetDepth(), 1);
}

ZTEST(overlay_host, test_a_scrim_tap_is_ignored_when_it_cannot_dismiss) {
    auto navigation_service = MakeNavigationWithOverlay();
    auto host = MakeHost(navigation_service);

    zassert_ok(PushOverlay(host, 1, OverlayOptions { .close_on_scrim_tap = false }));

    lv_obj_send_event(lv_obj_get_child(host->GetContainer()->GetObject(), 0), LV_EVENT_CLICKED, nullptr);

    zassert_true(navigation_service->IsOverlayActive());
}

ZTEST(overlay_host, test_an_overlay_closes_itself_when_its_time_is_up) {
    auto navigation_service = MakeNavigationWithOverlay();
    auto host = MakeHost(navigation_service);

    zassert_ok(PushOverlay(host, 1, OverlayOptions { .auto_close_ms = 10 }));
    zassert_true(navigation_service->IsOverlayActive());

    RunTimersFor(40);

    zassert_false(navigation_service->IsOverlayActive());
}

// A single-shot timer outliving the overlay it belongs to would close whatever
// took its place - or run against a destroyed host.
ZTEST(overlay_host, test_popping_cancels_a_pending_auto_close) {
    auto navigation_service = MakeNavigationWithOverlay();
    auto host = MakeHost(navigation_service);

    zassert_ok(PushOverlay(host, 1, OverlayOptions { .auto_close_ms = 10 }));
    zassert_ok(host->Pop());

    RunTimersFor(40);

    zassert_true(navigation_service->IsOverlayActive());
}

ZTEST(overlay_host, test_an_overlay_stacked_on_top_takes_over_closing) {
    auto navigation_service = MakeNavigationWithOverlay();
    auto host = MakeHost(navigation_service);

    zassert_ok(PushOverlay(host, 1, OverlayOptions { .auto_close_ms = 10 }));
    zassert_ok(PushOverlay(host, 2));

    RunTimersFor(40);

    // The elapsed timer belonged to the overlay underneath, which is not what a
    // close would remove.
    zassert_true(navigation_service->IsOverlayActive());
    zassert_equal(host->GetDepth(), 2);
}
```

## src/screen_group.cpp
```c
#include <memory>

#include <zephyr/ztest.h>
#include <lvgl.h>

#include "views/screens/screen_group.h"
#include "views/utilitites/frame.h"

#include "views_test_support.h"

using eerie_leap::views::screens::ScreenGroup;
using eerie_leap::views::utilitites::Frame;
using views_test::CleanTestDisplay;
using views_test::EnsureTestDisplay;
using views_test::FakeScreen;

namespace {

std::shared_ptr<Frame> MakeRoot() {
    return std::make_shared<Frame>(Frame::CreateWrapped()
        .SetWidth(100, false)
        .SetHeight(100, false)
        .Build());
}

bool IsHidden(const std::shared_ptr<ScreenGroup>& group) {
    return lv_obj_has_flag(group->GetContainer()->GetObject(), LV_OBJ_FLAG_HIDDEN);
}

void* SetUp() {
    EnsureTestDisplay();

    return nullptr;
}

} // namespace

ZTEST_SUITE(screen_group, NULL, SetUp, NULL, CleanTestDisplay, NULL);

ZTEST(screen_group, test_a_new_group_is_hidden_and_unrendered) {
    auto root = MakeRoot();
    auto group = std::make_shared<ScreenGroup>(4, root);

    zassert_equal(group->GetGroupId(), 4);
    zassert_true(group->IsEmpty());
    zassert_false(group->IsRendered());
    zassert_false(group->IsActivated());
    zassert_true(IsHidden(group));
}

ZTEST(screen_group, test_ensure_rendered_renders_the_screens_once) {
    auto root = MakeRoot();
    auto group = std::make_shared<ScreenGroup>(0, root);

    auto screen = std::make_shared<FakeScreen>(1, 0, 0, true, group->GetContainer());
    group->AddScreen(screen);

    zassert_equal(group->EnsureRendered(), 0);
    zassert_equal(group->EnsureRendered(), 0);

    zassert_true(group->IsRendered());
    zassert_equal(screen->render_count, 1);
}

ZTEST(screen_group, test_a_failing_screen_leaves_the_group_unrendered) {
    auto root = MakeRoot();
    auto group = std::make_shared<ScreenGroup>(0, root);

    auto screen = std::make_shared<FakeScreen>(1, 0, 0, true, group->GetContainer());
    screen->FailNextRenders();
    group->AddScreen(screen);

    zassert_not_equal(group->EnsureRendered(), 0);
    zassert_false(group->IsRendered());
    zassert_true(IsHidden(group));
}

// Activation is requested synchronously, but the LVGL tree may only be built
// later on the render work queue.
ZTEST(screen_group, test_activation_requested_before_rendering_is_applied_on_render) {
    auto root = MakeRoot();
    auto group = std::make_shared<ScreenGroup>(0, root);

    auto screen = std::make_shared<FakeScreen>(1, 0, 0, true, group->GetContainer());
    group->AddScreen(screen);

    group->Activate();

    zassert_false(group->IsActivated());
    zassert_equal(screen->activated_count, 0);
    zassert_true(IsHidden(group));

    zassert_equal(group->EnsureRendered(), 0);

    zassert_true(group->IsActivated());
    zassert_equal(screen->activated_count, 1);
    zassert_false(IsHidden(group));
}

// Two swipes in a row: the first group's queued render must not steal the
// screen back once it completes.
ZTEST(screen_group, test_deactivation_cancels_a_pending_activation) {
    auto root = MakeRoot();
    auto group = std::make_shared<ScreenGroup>(0, root);

    auto screen = std::make_shared<FakeScreen>(1, 0, 0, true, group->GetContainer());
    group->AddScreen(screen);

    group->Activate();
    group->Deactivate();

    zassert_equal(group->EnsureRendered(), 0);

    zassert_false(group->IsActivated());
    zassert_equal(screen->activated_count, 0);
    zassert_true(IsHidden(group));
}

ZTEST(screen_group, test_activate_and_deactivate_are_idempotent) {
    auto root = MakeRoot();
    auto group = std::make_shared<ScreenGroup>(0, root);

    auto screen = std::make_shared<FakeScreen>(1, 0, 0, true, group->GetContainer());
    group->AddScreen(screen);

    zassert_equal(group->EnsureRendered(), 0);

    group->Activate();
    group->Activate();
    zassert_equal(screen->activated_count, 1);

    group->Deactivate();
    group->Deactivate();
    zassert_equal(screen->deactivated_count, 1);
    zassert_true(IsHidden(group));

    group->Activate();
    zassert_equal(screen->activated_count, 2);
}

ZTEST(screen_group, test_an_invisible_screen_renders_but_is_not_activated) {
    auto root = MakeRoot();
    auto group = std::make_shared<ScreenGroup>(0, root);

    auto visible = std::make_shared<FakeScreen>(1, 0, 0, true, group->GetContainer());
    auto hidden = std::make_shared<FakeScreen>(2, 0, 0, false, group->GetContainer());
    group->AddScreen(visible);
    group->AddScreen(hidden);

    zassert_equal(group->EnsureRendered(), 0);
    group->Activate();

    zassert_equal(hidden->render_count, 1);
    zassert_equal(hidden->activated_count, 0);
    zassert_equal(visible->activated_count, 1);

    // Deactivation is unconditional: a screen made invisible while active still
    // has to be told to stand down.
    group->Deactivate();
    zassert_equal(hidden->deactivated_count, 1);
}

ZTEST(screen_group, test_get_screen_finds_screens_by_id) {
    auto root = MakeRoot();
    auto group = std::make_shared<ScreenGroup>(0, root);

    auto screen = std::make_shared<FakeScreen>(7, 0, 0, true, group->GetContainer());
    group->AddScreen(screen);
    group->AddScreen(nullptr);

    zassert_false(group->IsEmpty());
    zassert_equal(group->GetScreen(7).get(), screen.get());
    zassert_is_null(group->GetScreen(8).get());
}

// Sorting the vector alone changes nothing on screen: LVGL draws in child order.
ZTEST(screen_group, test_screens_are_drawn_in_z_index_order) {
    auto root = MakeRoot();
    auto group = std::make_shared<ScreenGroup>(0, root);

    auto top = std::make_shared<FakeScreen>(1, 0, 5, true, group->GetContainer());
    auto bottom = std::make_shared<FakeScreen>(2, 0, -5, true, group->GetContainer());
    auto middle = std::make_shared<FakeScreen>(3, 0, 0, true, group->GetContainer());

    group->AddScreen(top);
    group->AddScreen(bottom);
    group->AddScreen(middle);

    zassert_equal(group->EnsureRendered(), 0);

    auto* container = group->GetContainer()->GetObject();

    zassert_equal(lv_obj_get_index(bottom->GetContainer()->GetObject()), 0);
    zassert_equal(lv_obj_get_index(middle->GetContainer()->GetObject()), 1);
    zassert_equal(lv_obj_get_index(top->GetContainer()->GetObject()), 2);
    zassert_equal(lv_obj_get_child_count(container), 3);
}
```

## src/views_test_support.cpp
```c
#include <cerrno>
#include <utility>

#include <lvgl.h>

#include "views_test_support.h"

namespace views_test {

using eerie_leap::domain::ui_domain::models::ScreenConfiguration;
using eerie_leap::views::themes::ITheme;
using eerie_leap::views::utilitites::Frame;
using eerie_leap::views::widgets::IWidget;

namespace {

constexpr int32_t display_width = 466;
constexpr int32_t display_height = 466;
constexpr int32_t buffer_lines = 10;
constexpr int32_t max_bytes_per_pixel = 4;

uint8_t draw_buffer[display_width * buffer_lines * max_bytes_per_pixel];
lv_display_t* test_display = nullptr;

void FlushCb(lv_display_t* display, const lv_area_t* area, uint8_t* px_map) {
    lv_display_flush_ready(display);
}

} // namespace

void EnsureTestDisplay() {
    if(!lv_is_initialized())
        lv_init();

    if(test_display != nullptr)
        return;

    test_display = lv_display_create(display_width, display_height);
    lv_display_set_buffers(
        test_display,
        draw_buffer,
        nullptr,
        sizeof(draw_buffer),
        LV_DISPLAY_RENDER_MODE_PARTIAL);
    lv_display_set_flush_cb(test_display, FlushCb);
}

void CleanTestDisplay(void* fixture) {
    if(test_display != nullptr)
        lv_obj_clean(lv_screen_active());
}

FakeScreen::FakeScreen(
    uint32_t id,
    uint32_t screen_group_id,
    int32_t z_index,
    bool is_visible,
    std::shared_ptr<Frame> parent)
    : id_(id),
      screen_group_id_(screen_group_id),
      z_index_(z_index),
      is_visible_(is_visible),
      parent_(std::move(parent)) {}

void FakeScreen::FailNextRenders() {
    fails_to_render_ = true;
}

int FakeScreen::DoRender() {
    render_count++;

    if(fails_to_render_)
        return -EIO;

    container_ = std::make_shared<Frame>(Frame::CreateWrapped(parent_->GetObject())
        .SetWidth(100, false)
        .SetHeight(100, false)
        .Build());

    return 0;
}

int FakeScreen::ApplyTheme(const ITheme& theme) {
    return 0;
}

void FakeScreen::Configure(std::shared_ptr<ScreenConfiguration> configuration) {}

std::shared_ptr<ScreenConfiguration> FakeScreen::GetConfiguration() const {
    return nullptr;
}

std::shared_ptr<std::vector<std::unique_ptr<IWidget>>> FakeScreen::GetWidgets() const {
    return nullptr;
}

uint32_t FakeScreen::GetId() const {
    return id_;
}

uint32_t FakeScreen::GetGroupId() const {
    return screen_group_id_;
}

int32_t FakeScreen::GetZIndex() const {
    return z_index_;
}

bool FakeScreen::IsVisible() const {
    return is_visible_;
}

void FakeScreen::OnActivated() {
    activated_count++;
}

void FakeScreen::OnDeactivated() {
    deactivated_count++;
}

} // namespace views_test
```

## src/views_test_support.h
```c
#pragma once

#include <cstdint>
#include <memory>
#include <vector>

#include <lvgl.h>

#include "views/renderable_base.h"
#include "views/screens/i_screen.h"
#include "views/utilitites/frame.h"

namespace views_test {

// LVGL is built with CONFIG_LV_Z_AUTO_INIT=n in the test suites, so there is no
// display bound and lv_screen_active() would be null. A buffer-only display is
// enough for everything these tests assert: object trees, flags and child order.
void EnsureTestDisplay();

// Frames do not own their lv_obj_t, so a test's objects outlive it as orphaned
// children of the active screen.
void CleanTestDisplay(void* fixture);

// The real Screen pulls in a widget tree, a grid layout and a configuration;
// the group only ever calls the interface below.
class FakeScreen : public eerie_leap::views::RenderableBase,
                   public eerie_leap::views::screens::IScreen {
private:
    uint32_t id_;
    uint32_t screen_group_id_;
    int32_t z_index_;
    bool is_visible_;
    std::shared_ptr<eerie_leap::views::utilitites::Frame> parent_;
    bool fails_to_render_ = false;

    int DoRender() override;
    int ApplyTheme(const eerie_leap::views::themes::ITheme& theme) override;

public:
    FakeScreen(
        uint32_t id,
        uint32_t screen_group_id,
        int32_t z_index,
        bool is_visible,
        std::shared_ptr<eerie_leap::views::utilitites::Frame> parent);

    int render_count = 0;
    int activated_count = 0;
    int deactivated_count = 0;

    void FailNextRenders();

    void Configure(std::shared_ptr<eerie_leap::domain::ui_domain::models::ScreenConfiguration> configuration) override;
    std::shared_ptr<eerie_leap::domain::ui_domain::models::ScreenConfiguration> GetConfiguration() const override;
    std::shared_ptr<std::vector<std::unique_ptr<eerie_leap::views::widgets::IWidget>>> GetWidgets() const override;

    uint32_t GetId() const override;
    uint32_t GetGroupId() const override;
    int32_t GetZIndex() const override;
    bool IsVisible() const override;

    void OnActivated() override;
    void OnDeactivated() override;
};

} // namespace views_test
```
