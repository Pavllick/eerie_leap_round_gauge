## CMakeLists.txt
```
cmake_minimum_required(VERSION 3.20.0)

set(RT_GAUGE_TEST_SIM_FLASH ON)
include(${CMAKE_CURRENT_SOURCE_DIR}/../../../rt_gauge_test.cmake)

# Use Zephyr's build system
find_package(Zephyr REQUIRED HINTS $ENV{ZEPHYR_BASE})
project(functional_display_domain)

include_directories(${APP_SRC_DIR})

set(APP_SRC_CONFIGURATION_DIR ${APP_SRC_DIR}/configuration)
file(GLOB_RECURSE APP_SRC_CONFIGURATION
  ${APP_SRC_CONFIGURATION_DIR}/*.c
  ${APP_SRC_CONFIGURATION_DIR}/*.cpp
)

# Only the configuration half of the domain: DisplayService talks to the display
# driver, which the headless suites do not bind.
set(APP_SRC_DISPLAY_DOMAIN_DIR ${APP_SRC_DIR}/domain/display_domain/configuration)
file(GLOB_RECURSE APP_SRC_DISPLAY_DOMAIN
  ${APP_SRC_DISPLAY_DOMAIN_DIR}/*.c
  ${APP_SRC_DISPLAY_DOMAIN_DIR}/*.cpp
)

file(GLOB_RECURSE TEST_SOURCES src/*.c src/*.cpp)

# Add all source files to the app target
target_sources(app PRIVATE
  ${APP_SRC_CONFIGURATION}
  ${APP_SRC_DISPLAY_DOMAIN}
  ${TEST_SOURCES}
)
```

## prj.conf
```kconfig
CONFIG_ZTEST=y

#HW Version
CONFIG_EERIE_LEAP_HW_VERSION_MAJOR=2
CONFIG_EERIE_LEAP_HW_VERSION_MINOR=9
CONFIG_EERIE_LEAP_HW_VERSION_PATCH=6

#SW Version
CONFIG_EERIE_LEAP_SW_VERSION_MAJOR=7
CONFIG_EERIE_LEAP_SW_VERSION_MINOR=8
CONFIG_EERIE_LEAP_SW_VERSION_PATCH=4

# Language and Compiler
CONFIG_CPP=y
CONFIG_PICOLIBC=y
CONFIG_STD_CPP23=y
CONFIG_REQUIRES_FULL_LIBCPP=y
CONFIG_CPP_EXCEPTIONS=y
CONFIG_CPP_RTTI=y

# Memory
CONFIG_HEAP_MEM_POOL_SIZE=32768

# C++ exception unwinding needs considerably more stack than the ztest defaults.
CONFIG_MAIN_STACK_SIZE=8192
CONFIG_ZTEST_STACK_SIZE=8192

# Logging And Debugging
CONFIG_LOG=y
CONFIG_TEST_RANDOM_GENERATOR=y
CONFIG_THREAD_ANALYZER=y
CONFIG_THREAD_ANALYZER_USE_LOG=y
CONFIG_THREAD_RUNTIME_STATS=y
CONFIG_THREAD_NAME=y
CONFIG_SYS_HEAP_RUNTIME_STATS=y
CONFIG_THREAD_ANALYZER_ISR_STACK_USAGE=n

# FS Config
CONFIG_FLASH=y
CONFIG_FLASH_MAP=y
CONFIG_FILE_SYSTEM=y
CONFIG_FILE_SYSTEM_LITTLEFS=y
CONFIG_FILE_SYSTEM_MKFS=y

# CBOR
CONFIG_ZCBOR=y

CONFIG_CRC=y
CONFIG_TIMING_FUNCTIONS=y

CONFIG_EERIE_LEAP_RT_CORE=y
CONFIG_EERIE_LEAP_CONFIGURATION=y
CONFIG_EERIE_LEAP_DEVICE_TREE=y
CONFIG_EERIE_LEAP_FS=y
CONFIG_EERIE_LEAP_RANDOM=y
CONFIG_EERIE_LEAP_TIME=y
CONFIG_EERIE_LEAP_LUA_SCRIPT=y
CONFIG_EERIE_LEAP_MATH_PARSER=y
```

## src/display_configuration_manager.cpp
```c
#include <memory>
#include <span>
#include <vector>

#include <zephyr/kernel.h>
#include <zephyr/ztest.h>

#include "configuration/cbor/cbor_display_config/cbor_display_config.h"
#include "configuration/services/cbor_configuration_service.h"

#include "domain/configuration_domain/services/configuration_service.h"
#include "domain/display_domain/configuration/display_configuration_manager.h"
#include "domain/display_domain/models/display_configuration.h"

#include "subsys/device_tree/dt_fs.h"
#include "subsys/fs/services/fs_service.h"

using eerie_leap::configuration::services::CborConfigurationService;
using eerie_leap::subsys::device_tree::DtFs;
using eerie_leap::subsys::fs::services::FsService;
using eerie_leap::domain::configuration_domain::services::ConfigurationService;
using eerie_leap::domain::display_domain::configuration::DisplayConfigurationManager;
using eerie_leap::domain::display_domain::models::DisplayConfiguration;

namespace {

std::shared_ptr<DisplayConfigurationManager> MakeManager() {
    DtFs::InitInternalFs();
    auto fs_service = std::make_shared<FsService>(DtFs::GetInternalFsMp());

    fs_service->Format();

    auto cbor_display_configuration_service =
        std::make_unique<CborConfigurationService<CborDisplayConfig>>("display_config", fs_service);

    return std::make_shared<DisplayConfigurationManager>(
        std::move(cbor_display_configuration_service));
}

DisplayConfiguration MakeConfiguration() {
    DisplayConfiguration configuration;
    configuration.brightness = 42;
    configuration.blanking_enabled = true;
    configuration.screen_timeout_s = 90;
    configuration.theme_id = 4;

    return configuration;
}

} // namespace

ZTEST_SUITE(display_configuration_manager, NULL, NULL, NULL, NULL, NULL);

ZTEST(display_configuration_manager, test_an_empty_filesystem_yields_the_default_configuration) {
    auto manager = MakeManager();

    auto configuration = manager->Get();

    zassert_not_null(configuration.get());
    zassert_equal(configuration->brightness, 160);
    zassert_false(configuration->blanking_enabled);
}

ZTEST(display_configuration_manager, test_update_round_trips_through_flash) {
    auto manager = MakeManager();

    zassert_true(manager->Update(MakeConfiguration()));

    auto stored = manager->Get(true);

    zassert_equal(stored->brightness, 42);
    zassert_true(stored->blanking_enabled);
    zassert_equal(stored->screen_timeout_s, 90);
    zassert_equal(stored->theme_id, 4);
}

ZTEST(display_configuration_manager, test_cbor_configuration_round_trips) {
    auto manager = MakeManager();

    zassert_true(manager->Update(MakeConfiguration()));

    auto cbor = manager->GetCborConfiguration();
    zassert_true(cbor.size() > 0);

    DisplayConfiguration replacement;
    replacement.brightness = 7;
    zassert_true(manager->Update(replacement));
    zassert_equal(manager->Get(true)->brightness, 7);

    zassert_true(manager->ApplyCborConfiguration(std::span<const uint8_t>(cbor.data(), cbor.size())));

    auto restored = manager->Get(true);
    zassert_equal(restored->brightness, 42);
    zassert_true(restored->blanking_enabled);
    zassert_equal(restored->screen_timeout_s, 90);
}

// A configuration pushed from outside has to reach the driver without a reboot.
ZTEST(display_configuration_manager, test_apply_cbor_configuration_notifies_the_handler) {
    auto manager = MakeManager();

    zassert_true(manager->Update(MakeConfiguration()));
    auto cbor = manager->GetCborConfiguration();

    int notifications = 0;
    manager->RegisterConfigurationUpdatedHandler([&notifications] { notifications++; });

    // A local update is the service telling the manager what it already applied.
    zassert_true(manager->Update(MakeConfiguration()));
    zassert_equal(notifications, 0);

    zassert_true(manager->ApplyCborConfiguration(std::span<const uint8_t>(cbor.data(), cbor.size())));
    zassert_equal(notifications, 1);
}

ZTEST(display_configuration_manager, test_a_throwing_handler_does_not_fail_the_apply) {
    auto manager = MakeManager();

    zassert_true(manager->Update(MakeConfiguration()));
    auto cbor = manager->GetCborConfiguration();

    manager->RegisterConfigurationUpdatedHandler([] { throw std::runtime_error("boom"); });

    zassert_true(manager->ApplyCborConfiguration(std::span<const uint8_t>(cbor.data(), cbor.size())));
}

ZTEST(display_configuration_manager, test_garbage_cbor_is_rejected) {
    auto manager = MakeManager();

    zassert_true(manager->Update(MakeConfiguration()));

    std::vector<uint8_t> garbage = {0xFF, 0xFF, 0xFF, 0xFF};

    zassert_false(manager->ApplyCborConfiguration(std::span<const uint8_t>(garbage.data(), garbage.size())));
    zassert_equal(manager->Get(true)->brightness, 42);
}

ZTEST(display_configuration_manager, test_the_configuration_service_routes_the_display_type) {
    auto manager = MakeManager();
    zassert_true(manager->Update(MakeConfiguration()));

    ConfigurationService configuration_service;
    configuration_service.RegisterCborConfigurationManager(ConfigurationService::Type::Display, manager);

    auto cbor = configuration_service.GetCborConfiguration(ConfigurationService::Type::Display);
    zassert_true(cbor.size() > 0);

    DisplayConfiguration replacement;
    replacement.brightness = 9;
    zassert_true(manager->Update(replacement));

    zassert_true(configuration_service.ApplyCborConfiguration(
        ConfigurationService::Type::Display,
        std::span<const uint8_t>(cbor.data(), cbor.size())));

    zassert_equal(manager->Get(true)->brightness, 42);
}
```
