## CMakeLists.txt
```
cmake_minimum_required(VERSION 3.20.0)

include(${CMAKE_CURRENT_SOURCE_DIR}/../../rt_gauge_test.cmake)

# Use Zephyr's build system
find_package(Zephyr REQUIRED HINTS $ENV{ZEPHYR_BASE})
project(functional_event_bus)

include_directories(${APP_SRC_DIR})

set(APP_SRC_EVENT_BUS_DIR ${APP_SRC_DIR}/event_bus)
file(GLOB_RECURSE APP_SRC_EVENT_BUS
  ${APP_SRC_EVENT_BUS_DIR}/*.c
  ${APP_SRC_EVENT_BUS_DIR}/*.cpp
)

file(GLOB_RECURSE TEST_SOURCES src/*.c src/*.cpp)

# Add all source files to the app target
target_sources(app PRIVATE
  ${APP_SRC_EVENT_BUS}
  ${TEST_SOURCES}
)
```

## Kconfig
```
menu "Zephyr"
source "Kconfig.zephyr"
endmenu

config EERIE_LEAP_HW_VERSION_MAJOR
        int "Hardware version major"
        range 0 255
        default 0

config EERIE_LEAP_HW_VERSION_MINOR
        int "Hardware version minor"
        range 0 255
        default 0

config EERIE_LEAP_HW_VERSION_PATCH
        int "Hardware version patch"
        range 0 65535
        default 0

config EERIE_LEAP_SW_VERSION_MAJOR
        int "Software version major"
        range 0 255
        default 0

config EERIE_LEAP_SW_VERSION_MINOR
        int "Software version minor"
        range 0 255
        default 0

config EERIE_LEAP_SW_VERSION_PATCH
        int "Software version patch"
        range 0 65535
        default 0
```

## prj.conf
```kconfig
CONFIG_ZTEST=y

#HW Version
CONFIG_EERIE_LEAP_HW_VERSION_MAJOR=2
CONFIG_EERIE_LEAP_HW_VERSION_MINOR=9
CONFIG_EERIE_LEAP_HW_VERSION_PATCH=6

#SW Version
CONFIG_EERIE_LEAP_SW_VERSION_MAJOR=7
CONFIG_EERIE_LEAP_SW_VERSION_MINOR=8
CONFIG_EERIE_LEAP_SW_VERSION_PATCH=4

# Language and Compiler
CONFIG_CPP=y
CONFIG_PICOLIBC=y
CONFIG_STD_CPP23=y
CONFIG_REQUIRES_FULL_LIBCPP=y
CONFIG_CPP_EXCEPTIONS=y
CONFIG_CPP_RTTI=y

# Memory
CONFIG_HEAP_MEM_POOL_SIZE=32768

# C++ exception unwinding needs considerably more stack than the ztest defaults.
CONFIG_MAIN_STACK_SIZE=8192
CONFIG_ZTEST_STACK_SIZE=8192

# Logging And Debugging
CONFIG_LOG=y
CONFIG_TEST_RANDOM_GENERATOR=y
CONFIG_THREAD_NAME=y

CONFIG_EERIE_LEAP_RT_CORE=y
CONFIG_EERIE_LEAP_EVENT_BUS=y
```

## src/event_channel_registry.cpp
```c
#include <cstdint>
#include <optional>
#include <utility>
#include <variant>
#include <vector>

#include <zephyr/ztest.h>

#include "subsys/event_bus/event_bus.h"
#include "subsys/event_bus/event_channel.h"

#include "domain/logging_domain/event_bus/logging_events_channel.h"
#include "domain/settings_domain/event_bus/settings_events_channel.h"

#include "event_bus/event_channel_id.h"
#include "event_bus/event_channel_registry.h"

using eerie_leap::domain::logging_domain::event_bus::LoggingEventsChannel;
using eerie_leap::domain::logging_domain::event_bus::LoggingEventType;
using eerie_leap::domain::logging_domain::event_bus::LoggingPayloadType;
using eerie_leap::domain::settings_domain::event_bus::SettingsEventsChannel;
using eerie_leap::domain::settings_domain::event_bus::SettingsEventType;
using eerie_leap::domain::settings_domain::event_bus::SettingsPayloadType;
using eerie_leap::event_bus::EventChannelId;
using eerie_leap::event_bus::EventChannelRegistry;
using eerie_leap::subsys::event_bus::AnySubscription;
using eerie_leap::subsys::event_bus::CreateScopedSubscription;
using eerie_leap::subsys::event_bus::ErasedEventFilter;
using eerie_leap::subsys::event_bus::ErasedPayload;
using eerie_leap::subsys::event_bus::ErasedPayloadView;
using eerie_leap::subsys::event_bus::EventBus;
using eerie_leap::subsys::event_bus::EventData;

namespace {

constexpr int BUS_STACK_SIZE = 4096;

// Channels are inert until a bus drains them, so the suite owns one.
class TestEventBus : public EventBus {
public:
    TestEventBus() : EventBus("registry_test_bus", BUS_STACK_SIZE) {
        RegisterChannel(LoggingEventsChannel::GetInstance());
        RegisterChannel(SettingsEventsChannel::GetInstance());
    }
};

// Subscribes the way a widget binding does: by channel id and raw key, never naming the enums.
class ErasedProbe {
public:
    ErasedProbe(EventChannelId channel_id, uint32_t event_type, uint32_t payload_key,
        ErasedEventFilter selector = { }) {
        auto* channel = EventChannelRegistry::GetInstance().Find(channel_id);
        if(channel == nullptr)
            return;

        subscription_ = channel->SubscribeErased(
            event_type,
            selector,
            [this, payload_key](const ErasedPayloadView& view) {
                ++calls_;

                if(const auto* value = view.Find(payload_key))
                    last_value_ = *value;
            });
    }

    [[nodiscard]] bool IsSubscribed() const { return subscription_ != nullptr; }
    [[nodiscard]] int Calls() const { return calls_; }
    [[nodiscard]] const std::optional<EventData>& LastValue() const { return last_value_; }

private:
    AnySubscription subscription_;
    int calls_ = 0;
    std::optional<EventData> last_value_;
};

void PublishLoggingStatus(bool is_active) {
    LoggingEventsChannel::GetInstance().Publish({
        .source_id = 0x7E57,
        .type = LoggingEventType::StatusUpdated,
        .payload = { { LoggingPayloadType::IsActive, is_active } }
    });
}

void* RegisterChannels() {
    static TestEventBus bus;

    auto& registry = EventChannelRegistry::GetInstance();
    registry.Register(EventChannelId::Logging, LoggingEventsChannel::GetInstance());
    registry.Register(EventChannelId::Settings, SettingsEventsChannel::GetInstance());

    return nullptr;
}

} // namespace

ZTEST_SUITE(event_channel_registry, NULL, RegisterChannels, NULL, NULL, NULL);

ZTEST(event_channel_registry, test_registered_channel_resolves) {
    auto* channel = EventChannelRegistry::GetInstance().Find(EventChannelId::Logging);

    zassert_not_null(channel);
    zassert_equal(channel, &LoggingEventsChannel::GetInstance());
}

// A binding persisted before its channel existed must be inert, not fatal.
ZTEST(event_channel_registry, test_unregistered_channel_resolves_to_null) {
    zassert_is_null(EventChannelRegistry::GetInstance().Find(EventChannelId::None));
    zassert_is_null(EventChannelRegistry::GetInstance().Find(EventChannelId::Sensors));
    zassert_is_null(EventChannelRegistry::GetInstance().Find(static_cast<EventChannelId>(99)));
}

ZTEST(event_channel_registry, test_erased_subscribe_delivers_the_payload_key) {
    ErasedProbe probe(
        EventChannelId::Logging,
        std::to_underlying(LoggingEventType::StatusUpdated),
        std::to_underlying(LoggingPayloadType::IsActive));

    zassert_true(probe.IsSubscribed());

    PublishLoggingStatus(true);

    zassert_equal(probe.Calls(), 1);
    zassert_true(probe.LastValue().has_value());
    zassert_true(std::get<bool>(*probe.LastValue()));
}

ZTEST(event_channel_registry, test_erased_subscribe_reports_a_missing_key) {
    ErasedProbe probe(
        EventChannelId::Logging,
        std::to_underlying(LoggingEventType::StatusUpdated),
        0xDEAD);

    PublishLoggingStatus(true);

    zassert_equal(probe.Calls(), 1);
    zassert_false(probe.LastValue().has_value());
}

// The selector a binding carries runs here, so an event meant for another subscriber never
// reaches this handler at all.
ZTEST(event_channel_registry, test_erased_filter_rejects_before_the_handler) {
    auto is_active = [](const ErasedPayloadView& view) {
        const auto* value = view.Find(std::to_underlying(LoggingPayloadType::IsActive));

        return value != nullptr && std::get<bool>(*value);
    };

    ErasedProbe probe(
        EventChannelId::Logging,
        std::to_underlying(LoggingEventType::StatusUpdated),
        std::to_underlying(LoggingPayloadType::IsActive),
        is_active);

    PublishLoggingStatus(false);
    zassert_equal(probe.Calls(), 0);

    PublishLoggingStatus(true);
    zassert_equal(probe.Calls(), 1);
}

ZTEST(event_channel_registry, test_erased_subscription_unsubscribes_on_destruction) {
    {
        ErasedProbe probe(
            EventChannelId::Logging,
            std::to_underlying(LoggingEventType::StatusUpdated),
            std::to_underlying(LoggingPayloadType::IsActive));

        PublishLoggingStatus(true);
        zassert_equal(probe.Calls(), 1);
    }

    ErasedProbe observer(
        EventChannelId::Logging,
        std::to_underlying(LoggingEventType::StatusUpdated),
        std::to_underlying(LoggingPayloadType::IsActive));

    PublishLoggingStatus(false);

    zassert_equal(observer.Calls(), 1);
}

// The write half of a binding: publish by raw event type and keys, read back through the enums.
ZTEST(event_channel_registry, test_erased_publish_reaches_a_typed_subscriber) {
    std::vector<uint32_t> setting_ids;
    std::optional<float> value;

    auto subscription = CreateScopedSubscription(
        SettingsEventsChannel::GetInstance(),
        SettingsEventType::ChangeRequested,
        [&](const SettingsEventsChannel::EventMessage& event) {
            if(auto it = event.payload.find(SettingsPayloadType::SettingId); it != event.payload.end())
                setting_ids.push_back(std::get<uint32_t>(it->second));

            if(auto it = event.payload.find(SettingsPayloadType::Value); it != event.payload.end())
                value = std::get<float>(it->second);
        });

    zassert_not_null(subscription.get());

    auto* channel = EventChannelRegistry::GetInstance().Find(EventChannelId::Settings);
    zassert_not_null(channel);

    std::array<std::pair<uint32_t, EventData>, 2> payload {
        std::pair { std::to_underlying(SettingsPayloadType::Value), EventData { 42.0F } },
        std::pair { std::to_underlying(SettingsPayloadType::SettingId), EventData { uint32_t { 7 } } }
    };

    channel->PublishErasedAsync(
        std::to_underlying(SettingsEventType::ChangeRequested), 0x7E57, ErasedPayload { payload });

    k_msleep(200);

    zassert_equal(setting_ids.size(), 1U);
    zassert_equal(setting_ids.front(), 7U);
    zassert_true(value.has_value());
    zassert_equal(*value, 42.0F);
}
```

## src/ui_signal_bridge.cpp
```c
#include <cstdint>
#include <optional>
#include <variant>

#include <zephyr/ztest.h>

#include "subsys/event_bus/event_bus.h"
#include "subsys/event_bus/event_channel.h"

#include "domain/logging_domain/event_bus/logging_events_channel.h"
#include "domain/ui_domain/event_bus/ui_signal_channel.h"

#include "event_bus/ui_signal_bridge.h"

using eerie_leap::domain::logging_domain::event_bus::LoggingEventsChannel;
using eerie_leap::domain::logging_domain::event_bus::LoggingEventType;
using eerie_leap::domain::logging_domain::event_bus::LoggingPayloadType;
using eerie_leap::domain::ui_domain::event_bus::UiSignalChannel;
using eerie_leap::domain::ui_domain::event_bus::UiSignalPayloadType;
using eerie_leap::domain::ui_domain::event_bus::UiSignalType;
using eerie_leap::event_bus::UiSignalBridge;
using eerie_leap::subsys::event_bus::AnySubscription;
using eerie_leap::subsys::event_bus::CreateScopedSubscription;
using eerie_leap::subsys::event_bus::EventBus;

namespace {

constexpr int BUS_STACK_SIZE = 4096;

// Both ends of the bridge are inert until a bus drains them, so the suite owns one.
class TestEventBus : public EventBus {
public:
    TestEventBus() : EventBus("signal_test_bus", BUS_STACK_SIZE) {
        RegisterChannel(LoggingEventsChannel::GetInstance());
        RegisterChannel(UiSignalChannel::GetInstance());
    }
};

// The channels are singletons, so a probe subscribes for the lifetime of one test only.
class SignalProbe {
public:
    explicit SignalProbe(UiSignalType signal) {
        subscription_ = CreateScopedSubscription(
            UiSignalChannel::GetInstance(),
            signal,
            [this](const UiSignalChannel::EventMessage& event) {
                ++calls_;

                if(auto it = event.payload.find(UiSignalPayloadType::Value); it != event.payload.end())
                    if(const auto* value = std::get_if<bool>(&it->second))
                        last_value_ = *value;
            });
    }

    [[nodiscard]] int Calls() const { return calls_; }
    [[nodiscard]] std::optional<bool> LastValue() const { return last_value_; }

private:
    AnySubscription subscription_;
    int calls_ = 0;
    std::optional<bool> last_value_;
};

void PublishLoggingStatus(bool is_active) {
    LoggingEventsChannel::GetInstance().Publish({
        .source_id = 0x7E57,
        .type = LoggingEventType::StatusUpdated,
        .payload = { { LoggingPayloadType::IsActive, is_active } }
    });
}

} // namespace

ZTEST_SUITE(ui_signal_bridge, NULL, NULL, NULL, NULL, NULL);

ZTEST(ui_signal_bridge, test_a_linked_signal_reaches_the_ui_signal_channel) {
    TestEventBus bus;
    UiSignalBridge bridge;
    bridge.Initialize();

    SignalProbe probe(UiSignalType::LoggingActive);

    PublishLoggingStatus(true);

    zassert_equal(probe.Calls(), 1);
    zassert_true(probe.LastValue().has_value(), "the payload value was dropped in the bridge");
    zassert_true(probe.LastValue().value());
}

ZTEST(ui_signal_bridge, test_the_payload_value_survives_the_republish) {
    TestEventBus bus;
    UiSignalBridge bridge;
    bridge.Initialize();

    SignalProbe probe(UiSignalType::LoggingActive);

    PublishLoggingStatus(false);

    zassert_equal(probe.Calls(), 1);
    zassert_true(probe.LastValue().has_value());
    zassert_false(probe.LastValue().value(), "the bridge must forward the value, not a placeholder");
}

ZTEST(ui_signal_bridge, test_an_unlinked_signal_never_fires) {
    TestEventBus bus;
    UiSignalBridge bridge;
    bridge.Initialize();

    SignalProbe unlinked(UiSignalType::None);

    PublishLoggingStatus(true);

    zassert_equal(unlinked.Calls(), 0, "only linked signals may be published");
}

ZTEST(ui_signal_bridge, test_a_source_event_without_the_linked_key_is_ignored) {
    TestEventBus bus;
    UiSignalBridge bridge;
    bridge.Initialize();

    SignalProbe probe(UiSignalType::LoggingActive);

    LoggingEventsChannel::GetInstance().Publish({
        .source_id = 0x7E57,
        .type = LoggingEventType::StatusUpdated,
        .payload = {}
    });

    zassert_equal(probe.Calls(), 0);
}

ZTEST(ui_signal_bridge, test_nothing_is_republished_once_the_bridge_is_gone) {
    TestEventBus bus;
    SignalProbe probe(UiSignalType::LoggingActive);

    {
        UiSignalBridge bridge;
        bridge.Initialize();

        PublishLoggingStatus(true);

        zassert_equal(probe.Calls(), 1);
    }

    PublishLoggingStatus(true);

    zassert_equal(probe.Calls(), 1, "the bridge must drop its links when it is destroyed");
}
```
