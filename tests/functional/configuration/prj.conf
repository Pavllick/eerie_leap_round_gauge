## CMakeLists.txt
```
cmake_minimum_required(VERSION 3.20.0)

set(RT_GAUGE_TEST_SIM_FLASH ON)
include(${CMAKE_CURRENT_SOURCE_DIR}/../../rt_gauge_test.cmake)

# Use Zephyr's build system
find_package(Zephyr REQUIRED HINTS $ENV{ZEPHYR_BASE})
project(functional_configuration)

include_directories(${APP_SRC_DIR})

set(APP_SRC_CONFIGURATION_DIR ${APP_SRC_DIR}/configuration)
file(GLOB_RECURSE APP_SRC_CONFIGURATION
  ${APP_SRC_CONFIGURATION_DIR}/*.c
  ${APP_SRC_CONFIGURATION_DIR}/*.cpp
)

file(GLOB_RECURSE TEST_SOURCES src/*.c src/*.cpp)

# Add all source files to the app target
target_sources(app PRIVATE
  ${APP_SRC_CONFIGURATION}
  ${TEST_SOURCES}
)
```

## Kconfig
```
menu "Zephyr"
source "Kconfig.zephyr"
endmenu

config EERIE_LEAP_FS_SD_THREAD_STACK_SIZE
	int "SD thread stack size"
	default 2048

config EERIE_LEAP_ADC_VOLTAGE_MAX_MV
	int "ADC voltage max"
	default 3100

config EERIE_LEAP_SENSOR_VOLTAGE_MAX_MV
	int "Sensor voltage max"
	default 5000

config EERIE_LEAP_SD_CHECK_INTERVAL_MS
	int "SD check interval ms"
	default 1000
```

## prj.conf
```kconfig
CONFIG_ZTEST=y

# Language and Compiler
CONFIG_CPP=y
CONFIG_PICOLIBC=y
CONFIG_STD_CPP23=y
CONFIG_REQUIRES_FULL_LIBCPP=y
CONFIG_CPP_EXCEPTIONS=y
CONFIG_CPP_RTTI=y

# Memory
CONFIG_HEAP_MEM_POOL_SIZE=32768

# C++ exception unwinding needs considerably more stack than the ztest defaults.
CONFIG_MAIN_STACK_SIZE=8192
CONFIG_ZTEST_STACK_SIZE=8192

# Logging And Debugging
CONFIG_LOG=y
CONFIG_TEST_RANDOM_GENERATOR=y
CONFIG_THREAD_ANALYZER=y
CONFIG_THREAD_ANALYZER_USE_LOG=y
CONFIG_THREAD_RUNTIME_STATS=y
CONFIG_THREAD_NAME=y
CONFIG_SYS_HEAP_RUNTIME_STATS=y
CONFIG_THREAD_ANALYZER_ISR_STACK_USAGE=n

# FS Config
CONFIG_FLASH=y
CONFIG_FLASH_MAP=y
CONFIG_FILE_SYSTEM=y
CONFIG_FILE_SYSTEM_LITTLEFS=y
CONFIG_FILE_SYSTEM_MKFS=y

# CBOR
CONFIG_ZCBOR=y

CONFIG_CRC=y

CONFIG_EERIE_LEAP_RT_CORE=y
CONFIG_EERIE_LEAP_CONFIGURATION=y
CONFIG_EERIE_LEAP_DEVICE_TREE=y
CONFIG_EERIE_LEAP_FS=y
CONFIG_EERIE_LEAP_RANDOM=y
```

## src/configuration_service_system_config.cpp
```c
#include <memory>
#include <zephyr/ztest.h>

#include "utilities/cbor/cbor_helpers.hpp"
#include "configuration/cbor/cbor_system_config/cbor_system_config.h"
#include "configuration/services/cbor_configuration_service.h"

#include "subsys/device_tree/dt_fs.h"
#include "subsys/fs/services/i_fs_service.h"
#include "subsys/fs/services/fs_service.h"

using namespace eerie_leap::utilities::cbor;
using namespace eerie_leap::configuration::services;
using namespace eerie_leap::subsys::fs::services;
using namespace eerie_leap::subsys::device_tree;

ZTEST_SUITE(configuration_service_system_config, NULL, NULL, NULL, NULL, NULL);

ZTEST(configuration_service_system_config, test_CborSystemConfig_Save_config_successfully_saved) {
    CborSystemConfig system_config;
    memset(&system_config, 0, sizeof(system_config));

    system_config.device_id = 12;
    system_config.hw_version = 22;
    system_config.sw_version = 2422;

    DtFs::InitInternalFs();
    auto fs_service = std::make_shared<FsService>(DtFs::GetInternalFsMp().value());

    fs_service->Format();
    auto system_config_service = std::make_shared<CborConfigurationService<CborSystemConfig>>("system_config", fs_service);

    auto save_res = system_config_service->Save(&system_config);
    zassert_true(save_res);
}

ZTEST(configuration_service_system_config, test_CborSystemConfig_Load_config_successfully_saved_and_loaded) {
    CborSystemConfig system_config;
    memset(&system_config, 0, sizeof(system_config));

    system_config.device_id = 14;
    system_config.hw_version = 46;
    system_config.sw_version = 8624;

    DtFs::InitInternalFs();
    auto fs_service = std::make_shared<FsService>(DtFs::GetInternalFsMp().value());

    fs_service->Format();
    auto system_config_service = std::make_shared<CborConfigurationService<CborSystemConfig>>("system_config", fs_service);

    auto save_res = system_config_service->Save(&system_config);
    zassert_true(save_res);

    auto loaded_config = system_config_service->Load();
    zassert_true(loaded_config.has_value());
    zassert_equal(loaded_config.value().config->device_id, 14);
    zassert_equal(loaded_config.value().config->hw_version, 46);
    zassert_equal(loaded_config.value().config->sw_version, 8624);
}
```
