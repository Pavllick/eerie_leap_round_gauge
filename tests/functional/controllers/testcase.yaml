## tests/functional/controllers/testcase.yaml
```yaml
common:
  tags:
    - functional
    - controllers
  platform_allow:
    - native_sim
    - qemu_cortex_a9
    - qemu_cortex_a53
    - qemu_riscv64
    - qemu_malta

tests:
  functional.controllers: {}
```

## tests/functional/domain/display_domain/testcase.yaml
```yaml
common:
  tags:
    - functional
    - domain.display
  platform_allow:
    - native_sim
    - qemu_cortex_a9
    - qemu_cortex_a53
    - qemu_riscv64
    - qemu_malta

tests:
  functional.display_domain: {}
```

## tests/functional/event_bus/testcase.yaml
```yaml
common:
  tags:
    - functional
    - event_bus
  platform_allow:
    - native_sim
    - qemu_cortex_a9
    - qemu_cortex_a53
    - qemu_riscv64
    - qemu_malta

tests:
  functional.event_bus: {}
```

## tests/unit/domain/testcase.yaml
```yaml
common:
  tags:
    - unit
    - domain
  platform_allow:
    - native_sim
    - qemu_cortex_a9
    - qemu_cortex_a53
    - qemu_riscv64
    - qemu_malta

tests:
  unit.domain: {}
```
