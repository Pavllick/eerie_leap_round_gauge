## CMakeLists.txt
```
cmake_minimum_required(VERSION 3.20.0)

set(RT_GAUGE_TEST_SIM_FLASH ON)
set(RT_GAUGE_TEST_LVGL ON)
include(${CMAKE_CURRENT_SOURCE_DIR}/../../rt_gauge_test.cmake)

# Use Zephyr's build system
find_package(Zephyr REQUIRED HINTS $ENV{ZEPHYR_BASE})
project(unit_domain)

include_directories(${APP_SRC_DIR})

set(APP_SRC_CONFIGURATION_DIR ${APP_SRC_DIR}/configuration)
file(GLOB_RECURSE APP_SRC_CONFIGURATION
  ${APP_SRC_CONFIGURATION_DIR}/*.c
  ${APP_SRC_CONFIGURATION_DIR}/*.cpp
)

set(APP_SRC_UI_DOMAIN_DIR ${APP_SRC_DIR}/domain/ui_domain)
file(GLOB_RECURSE APP_SRC_UI_DOMAIN
  ${APP_SRC_UI_DOMAIN_DIR}/models/*.cpp
  ${APP_SRC_UI_DOMAIN_DIR}/configuration/parsers/*.cpp
)

file(GLOB_RECURSE TEST_SOURCES src/*.c src/*.cpp)

# Add all source files to the app target
target_sources(app PRIVATE
  ${APP_SRC_CONFIGURATION}
  ${APP_SRC_UI_DOMAIN}
  ${APP_SRC_DIR}/domain/display_domain/configuration/parsers/display_configuration_cbor_parser.cpp
  ${APP_SRC_DIR}/views/utilitites/grid_layout.cpp
  ${TEST_SOURCES}
)
```

## prj.conf
```kconfig
CONFIG_ZTEST=y

#HW Version
CONFIG_EERIE_LEAP_HW_VERSION_MAJOR=2
CONFIG_EERIE_LEAP_HW_VERSION_MINOR=9
CONFIG_EERIE_LEAP_HW_VERSION_PATCH=6

#SW Version
CONFIG_EERIE_LEAP_SW_VERSION_MAJOR=7
CONFIG_EERIE_LEAP_SW_VERSION_MINOR=8
CONFIG_EERIE_LEAP_SW_VERSION_PATCH=4

# Language and Compiler
CONFIG_CPP=y
CONFIG_PICOLIBC=y
CONFIG_STD_CPP2B=y
CONFIG_REQUIRES_FULL_LIBCPP=y
CONFIG_CPP_EXCEPTIONS=y
CONFIG_CPP_RTTI=y

# Memory
CONFIG_HEAP_MEM_POOL_SIZE=32768

# Logging And Debugging
CONFIG_LOG=y
CONFIG_TEST_RANDOM_GENERATOR=y
CONFIG_THREAD_ANALYZER=y
CONFIG_THREAD_ANALYZER_USE_LOG=y
CONFIG_THREAD_RUNTIME_STATS=y
CONFIG_THREAD_NAME=y
CONFIG_SYS_HEAP_RUNTIME_STATS=y
CONFIG_THREAD_ANALYZER_ISR_STACK_USAGE=n

# FS Config
CONFIG_FLASH=y
CONFIG_FLASH_MAP=y
CONFIG_FILE_SYSTEM=y
CONFIG_FILE_SYSTEM_LITTLEFS=y
CONFIG_FILE_SYSTEM_MKFS=y

# CBOR
CONFIG_ZCBOR=y

# LVGL
CONFIG_LVGL=y
CONFIG_LV_Z_MEM_POOL_SIZE=32768

CONFIG_CRC=y
CONFIG_TIMING_FUNCTIONS=y

CONFIG_EERIE_LEAP_RT_CORE=y
CONFIG_EERIE_LEAP_CONFIGURATION=y
CONFIG_EERIE_LEAP_FS=y
CONFIG_EERIE_LEAP_DBC=y
CONFIG_EERIE_LEAP_RANDOM=y
CONFIG_EERIE_LEAP_TIME=y
CONFIG_EERIE_LEAP_LUA_SCRIPT=y
CONFIG_EERIE_LEAP_MATH_PARSER=y
```

## boards/native_sim.conf
```kconfig
CONFIG_FLASH_SIMULATOR=y

CONFIG_DISPLAY=y
CONFIG_INPUT=y
```

## src/display_configuration_cbor_parser.cpp
```c
#include <cstdint>
#include <stdexcept>
#include <string>

#include <zephyr/ztest.h>

#include "utilities/memory/memory_resource_manager.h"

#include "configuration/cbor/cbor_display_config/cbor_display_config.h"
#include "domain/display_domain/configuration/parsers/display_configuration_cbor_parser.h"
#include "domain/display_domain/models/display_configuration.h"

using eerie_leap::utilities::memory::Mrm;
using eerie_leap::domain::display_domain::models::DisplayConfiguration;
using eerie_leap::domain::display_domain::configuration::parsers::DisplayConfigurationCborParser;

namespace {

template<typename Fn>
std::string ThrownMessage(Fn&& fn) {
    try {
        fn();
    } catch(const std::exception& e) {
        return e.what();
    } catch(...) {
        return "unexpected exception";
    }

    return "no exception";
}

CborDisplayConfig MakeCborConfig() {
    return CborDisplayConfig {
        .version = DisplayConfigurationCborParser::configuration_version,
        .brightness = 200,
        .blanking_enabled = true,
        .screen_timeout_s = 45,
        .theme_id = 3
    };
}

} // namespace

ZTEST_SUITE(display_configuration_cbor_parser, NULL, NULL, NULL, NULL, NULL);

ZTEST(display_configuration_cbor_parser, test_defaults_leave_the_panel_lit) {
    DisplayConfiguration configuration;

    zassert_equal(configuration.brightness, 160);
    zassert_false(configuration.blanking_enabled);
    zassert_equal(configuration.screen_timeout_s, 0);
    zassert_equal(configuration.theme_id, 0);
}

ZTEST(display_configuration_cbor_parser, test_serialize_stamps_the_current_version) {
    DisplayConfigurationCborParser parser;

    DisplayConfiguration configuration;
    configuration.brightness = 12;

    auto config = parser.Serialize(configuration);

    zassert_equal(config->version, DisplayConfigurationCborParser::configuration_version);
    zassert_equal(config->brightness, 12);
}

ZTEST(display_configuration_cbor_parser, test_round_trip_preserves_every_field) {
    DisplayConfigurationCborParser parser;

    DisplayConfiguration configuration;
    configuration.brightness = 77;
    configuration.blanking_enabled = true;
    configuration.screen_timeout_s = 30;
    configuration.theme_id = 2;

    auto config = parser.Serialize(configuration);
    auto restored = parser.Deserialize(Mrm::GetDefaultPmr(), *config);

    zassert_equal(restored->brightness, 77);
    zassert_true(restored->blanking_enabled);
    zassert_equal(restored->screen_timeout_s, 30);
    zassert_equal(restored->theme_id, 2);
}

ZTEST(display_configuration_cbor_parser, test_deserialize_accepts_the_current_version) {
    DisplayConfigurationCborParser parser;

    auto config = MakeCborConfig();
    auto restored = parser.Deserialize(Mrm::GetDefaultPmr(), config);

    zassert_equal(restored->brightness, 200);
    zassert_true(restored->blanking_enabled);
    zassert_equal(restored->screen_timeout_s, 45);
    zassert_equal(restored->theme_id, 3);
}

// A stored config written by another layout must fail loudly so the manager
// regenerates defaults instead of reading field-shifted values.
ZTEST(display_configuration_cbor_parser, test_deserialize_rejects_another_version) {
    DisplayConfigurationCborParser parser;

    auto config = MakeCborConfig();
    config.version = DisplayConfigurationCborParser::configuration_version + 1;

    auto message = ThrownMessage([&] { parser.Deserialize(Mrm::GetDefaultPmr(), config); });

    zassert_equal(
        message,
        "Invalid Display configuration. Unsupported version: "
            + std::to_string(DisplayConfigurationCborParser::configuration_version + 1)
            + ". Expected: "
            + std::to_string(DisplayConfigurationCborParser::configuration_version)
            + ".",
        "%s",
        message.c_str());
}

// The schema stores brightness as a uint; the model is a uint8_t.
ZTEST(display_configuration_cbor_parser, test_deserialize_rejects_out_of_range_brightness) {
    DisplayConfigurationCborParser parser;

    auto config = MakeCborConfig();
    config.brightness = 256;

    auto message = ThrownMessage([&] { parser.Deserialize(Mrm::GetDefaultPmr(), config); });

    zassert_equal(
        message,
        "Invalid Display configuration. Brightness must be between 0 and 255. Value: 256.",
        "%s",
        message.c_str());
}

ZTEST(display_configuration_cbor_parser, test_deserialize_accepts_the_brightness_bounds) {
    DisplayConfigurationCborParser parser;

    auto config = MakeCborConfig();
    config.brightness = 255;
    zassert_equal(parser.Deserialize(Mrm::GetDefaultPmr(), config)->brightness, 255);

    config.brightness = 0;
    zassert_equal(parser.Deserialize(Mrm::GetDefaultPmr(), config)->brightness, 0);
}
```

## src/grid_layout.cpp
```c
#include <cstdint>
#include <stdexcept>
#include <string>

#include <zephyr/ztest.h>

#include "domain/ui_domain/models/grid_settings.h"
#include "domain/ui_domain/models/widget_position.h"
#include "domain/ui_domain/models/widget_size.h"
#include "views/utilitites/grid_layout.h"

using eerie_leap::domain::ui_domain::models::GridSettings;
using eerie_leap::domain::ui_domain::models::WidgetPosition;
using eerie_leap::domain::ui_domain::models::WidgetSize;
using eerie_leap::views::utilitites::GridLayout;

namespace {

constexpr int32_t SCREEN_SIZE = 400;

GridSettings MakeGrid(uint32_t width, uint32_t height, uint32_t spacing_px) {
    return GridSettings {
        .snap_enabled = false,
        .width = width,
        .height = height,
        .spacing_px = spacing_px
    };
}

// GridLayout::FromActiveScreen() needs a bound display, so the tests build the
// layout against a fixed screen size instead.
GridLayout MakeLayout(uint32_t grid_width, uint32_t grid_height, uint32_t spacing_px) {
    return {MakeGrid(grid_width, grid_height, spacing_px), SCREEN_SIZE, SCREEN_SIZE};
}

std::string InvalidArgumentMessage(const GridSettings& grid, int32_t screen_width, int32_t screen_height) {
    try {
        GridLayout layout(grid, screen_width, screen_height);
    } catch(const std::invalid_argument& e) {
        return e.what();
    } catch(...) {
        return "unexpected exception";
    }

    return "no exception";
}

template<typename Fn>
std::string ThrownMessage(Fn&& fn) {
    try {
        fn();
    } catch(const std::exception& e) {
        return e.what();
    } catch(...) {
        return "unexpected exception";
    }

    return "no exception";
}

} // namespace

ZTEST_SUITE(grid_layout, NULL, NULL, NULL, NULL, NULL);

ZTEST(grid_layout, test_a_widget_spanning_the_whole_grid_fills_the_screen) {
    auto layout = MakeLayout(4, 4, 5);

    auto size_px = layout.ToPx(WidgetSize {.width = 4, .height = 4});

    // The full-span shortcut ignores the spacing so the widget reaches the edges.
    zassert_equal(size_px.width, static_cast<uint32_t>(SCREEN_SIZE));
    zassert_equal(size_px.height, static_cast<uint32_t>(SCREEN_SIZE));
}

ZTEST(grid_layout, test_a_cell_sized_widget_is_one_grid_step_without_spacing) {
    auto layout = MakeLayout(4, 4, 0);

    auto size_px = layout.ToPx(WidgetSize {.width = 1, .height = 1});

    zassert_equal(size_px.width, 100U);
    zassert_equal(size_px.height, 100U);
}

ZTEST(grid_layout, test_the_spacing_is_removed_from_both_edges_of_a_widget) {
    auto layout = MakeLayout(4, 4, 5);

    auto size_px = layout.ToPx(WidgetSize {.width = 1, .height = 1});

    // 400 / 4 - 5 * 2
    zassert_equal(size_px.width, 90U);
    zassert_equal(size_px.height, 90U);
}

ZTEST(grid_layout, test_a_widget_scales_with_the_number_of_cells_it_spans) {
    auto layout = MakeLayout(4, 4, 0);

    auto size_px = layout.ToPx(WidgetSize {.width = 2, .height = 3});

    zassert_equal(size_px.width, 200U);
    zassert_equal(size_px.height, 300U);
}

ZTEST(grid_layout, test_each_axis_uses_its_own_grid_extent) {
    GridLayout layout(MakeGrid(2, 8, 0), SCREEN_SIZE, SCREEN_SIZE);

    auto size_px = layout.ToPx(WidgetSize {.width = 1, .height = 1});

    zassert_equal(size_px.width, 200U);
    zassert_equal(size_px.height, 50U);
}

ZTEST(grid_layout, test_the_origin_sits_at_the_bottom_left_of_the_screen) {
    auto layout = MakeLayout(4, 4, 0);
    WidgetSize size_px {.width = 100, .height = 100};

    auto position_px = layout.ToPx(WidgetPosition {.x = 0, .y = 0}, size_px);

    // Grid y counts up from the bottom, pixel y counts down from the top.
    zassert_equal(position_px.x, 0);
    zassert_equal(position_px.y, 300);
}

ZTEST(grid_layout, test_the_top_row_lands_flush_with_the_top_edge) {
    auto layout = MakeLayout(4, 4, 0);
    WidgetSize size_px {.width = 100, .height = 100};

    auto position_px = layout.ToPx(WidgetPosition {.x = 1, .y = 3}, size_px);

    zassert_equal(position_px.x, 100);
    zassert_equal(position_px.y, 0);
}

ZTEST(grid_layout, test_a_position_advances_by_whole_cells) {
    auto layout = MakeLayout(4, 4, 0);
    WidgetSize size_px {.width = 100, .height = 100};

    auto position_px = layout.ToPx(WidgetPosition {.x = 3, .y = 1}, size_px);

    zassert_equal(position_px.x, 300);
    zassert_equal(position_px.y, 200);
}

ZTEST(grid_layout, test_the_spacing_widens_the_cell_step_of_a_position) {
    auto layout = MakeLayout(4, 4, 5);
    WidgetSize size_px {.width = 90, .height = 90};

    // Cell step is 400 / 4 + 5 * 2.
    auto position_px = layout.ToPx(WidgetPosition {.x = 2, .y = 2}, size_px);

    zassert_equal(position_px.x, 220);
    zassert_equal(position_px.y, 90);
}

ZTEST(grid_layout, test_a_grid_wider_than_the_screen_is_rejected) {
    zassert_equal(
        InvalidArgumentMessage(MakeGrid(SCREEN_SIZE + 1, 4, 0), SCREEN_SIZE, SCREEN_SIZE),
        std::string("Invalid screen width."));
}

ZTEST(grid_layout, test_a_grid_taller_than_the_screen_is_rejected) {
    zassert_equal(
        InvalidArgumentMessage(MakeGrid(4, SCREEN_SIZE + 1, 0), SCREEN_SIZE, SCREEN_SIZE),
        std::string("Invalid screen height."));
}

ZTEST(grid_layout, test_an_empty_grid_axis_is_rejected) {
    zassert_equal(
        InvalidArgumentMessage(MakeGrid(0, 4, 0), SCREEN_SIZE, SCREEN_SIZE),
        std::string("Invalid screen width."));

    zassert_equal(
        InvalidArgumentMessage(MakeGrid(4, 0, 0), SCREEN_SIZE, SCREEN_SIZE),
        std::string("Invalid screen height."));
}

ZTEST(grid_layout, test_an_unsized_screen_is_rejected) {
    zassert_equal(
        InvalidArgumentMessage(MakeGrid(4, 4, 0), 0, SCREEN_SIZE),
        std::string("Invalid active screen size."));

    zassert_equal(
        InvalidArgumentMessage(MakeGrid(4, 4, 0), SCREEN_SIZE, -1),
        std::string("Invalid active screen size."));
}

ZTEST(grid_layout, test_a_widget_without_an_extent_is_rejected) {
    auto layout = MakeLayout(4, 4, 0);

    zassert_equal(
        ThrownMessage([&layout] { (void)layout.ToPx(WidgetSize {.width = 0, .height = 1}); }),
        std::string("Invalid widget width."));

    zassert_equal(
        ThrownMessage([&layout] { (void)layout.ToPx(WidgetSize {.width = 1, .height = 0}); }),
        std::string("Invalid widget height."));
}

ZTEST(grid_layout, test_positioning_a_widget_of_unknown_size_is_rejected) {
    auto layout = MakeLayout(4, 4, 0);
    WidgetPosition position_grid {.x = 0, .y = 0};

    zassert_equal(
        ThrownMessage([&layout, &position_grid] {
            (void)layout.ToPx(position_grid, WidgetSize {.width = 0, .height = 0});
        }),
        std::string("Widget size is not set."));
}
```

## src/ui_configuration_parser.cpp
```c
#include <memory>
#include <stdexcept>

#include <zephyr/kernel.h>
#include <zephyr/ztest.h>
#include <eerie_memory.hpp>

#include "configuration/services/cbor_configuration_service.h"

#include "domain/ui_domain/models/ui_configuration.h"
#include "domain/ui_domain/models/widget_type.h"
#include "domain/ui_domain/models/widget_property.h"
#include "domain/ui_domain/configuration/parsers/ui_configuration_cbor_parser.h"

#include "views/widgets/indicators/horizontal_chart_indicator/horizontal_chart_indicator.h"

using namespace eerie_memory;
using namespace eerie_leap::configuration::services;
using namespace eerie_leap::domain::ui_domain::models;
using namespace eerie_leap::domain::ui_domain::configuration;
using namespace eerie_leap::domain::ui_domain::configuration::parsers;
using namespace eerie_leap::views::widgets::indicators;

ZTEST_SUITE(ui_configuration_parser, NULL, NULL, NULL, NULL, NULL);

pmr_unique_ptr<UiConfiguration> ui_configuration_parser_GetTestUiConfiguration() {
    auto ui_configuration = make_unique_pmr<UiConfiguration>(Mrm::GetDefaultPmr());
    ui_configuration->active_screen_group_id = 3;

    auto screen_configuration = make_shared_pmr<ScreenConfiguration>(Mrm::GetDefaultPmr());
    screen_configuration->id = 8;
    screen_configuration->screen_group_id = 3;
    screen_configuration->type = ScreenType::Gauge;
    screen_configuration->z_index = -2;
    screen_configuration->is_visible = true;
    screen_configuration->is_overlay = true;

    screen_configuration->grid.snap_enabled = true;
    screen_configuration->grid.width = 3;
    screen_configuration->grid.height = 3;
    screen_configuration->grid.spacing_px = 0;

    // First widget
    auto widget1 = make_shared_pmr<WidgetConfiguration>(Mrm::GetDefaultPmr());
    widget1->type = WidgetType::IndicatorArcFill;
    widget1->id = 0;
    widget1->position_grid.x = 0;
    widget1->position_grid.y = 0;
    widget1->size_grid.width = 3;
    widget1->size_grid.height = 3;
    widget1->z_index = -1;
    widget1->properties[WidgetProperty::GetTypeName(WidgetPropertyType::MIN_VALUE)] = 0;
    widget1->properties[WidgetProperty::GetTypeName(WidgetPropertyType::MAX_VALUE)] = 100;
    widget1->properties[WidgetProperty::GetTypeName(WidgetPropertyType::LABEL)] = "sensor_1";

    // Two targets fed by one source, which is the fan-out the binding list exists for.
    PropertyBinding value_binding;
    value_binding.target = WidgetPropertyType::VALUE;
    value_binding.channel = EventChannelId::Sensors;
    value_binding.event_type = 0;
    value_binding.payload_key = 1;
    value_binding.selector_key = 0;
    value_binding.selector_value = std::pmr::string("sensor_1");
    widget1->bindings.push_back(std::move(value_binding));

    PropertyBinding visibility_binding;
    visibility_binding.target = WidgetPropertyType::IS_VISIBLE;
    visibility_binding.channel = EventChannelId::Sensors;
    visibility_binding.event_type = 0;
    visibility_binding.payload_key = 1;
    visibility_binding.selector_key = 0;
    visibility_binding.selector_value = std::pmr::string("sensor_1");
    widget1->bindings.push_back(std::move(visibility_binding));

    screen_configuration->AddWidget(std::move(widget1));

    // Second widget
    auto widget2 = make_shared_pmr<WidgetConfiguration>(Mrm::GetDefaultPmr());
    widget2->type = WidgetType::IndicatorDigital;
    widget2->id = 1;
    widget2->position_grid.x = 1;
    widget2->position_grid.y = 1;
    widget2->size_grid.width = 1;
    widget2->size_grid.height = 1;
    widget2->properties[WidgetProperty::GetTypeName(WidgetPropertyType::IS_VISIBLE)] = false;
    widget2->properties[WidgetProperty::GetTypeName(WidgetPropertyType::MIN_VALUE)] = 0;
    widget2->properties[WidgetProperty::GetTypeName(WidgetPropertyType::MAX_VALUE)] = 100;
    widget2->properties[WidgetProperty::GetTypeName(WidgetPropertyType::LABEL)] = "sensor_1";

    // Two-way and unconditional: the selector stays unset and the outbound event carries the write.
    PropertyBinding setting_binding;
    setting_binding.target = WidgetPropertyType::VALUE;
    setting_binding.channel = EventChannelId::Settings;
    setting_binding.event_type = 0;
    setting_binding.payload_key = 1;
    setting_binding.direction = PropertyBindingDirection::InOut;
    setting_binding.outbound_event_type = 2;
    widget2->bindings.push_back(std::move(setting_binding));

    screen_configuration->AddWidget(std::move(widget2));

    // Third widget
    auto widget3 = make_shared_pmr<WidgetConfiguration>(Mrm::GetDefaultPmr());
    widget3->type = WidgetType::IndicatorHorizontalChart;
    widget3->id = 2;
    widget3->position_grid.x = 0;
    widget3->position_grid.y = 0;
    widget3->size_grid.width = 3;
    widget3->size_grid.height = 1;
    widget3->z_index = 2;
    widget3->properties[WidgetProperty::GetTypeName(WidgetPropertyType::MIN_VALUE)] = 0;
    widget3->properties[WidgetProperty::GetTypeName(WidgetPropertyType::MAX_VALUE)] = 100;
    widget3->properties[WidgetProperty::GetTypeName(WidgetPropertyType::LABEL)] = "sensor_1";
    widget3->properties[WidgetProperty::GetTypeName(WidgetPropertyType::CHART_POINT_COUNT)] = 35;
    widget3->properties[WidgetProperty::GetTypeName(WidgetPropertyType::CHART_TYPE)] = static_cast<std::uint16_t>(HorizontalChartIndicatorType::Line);
    screen_configuration->AddWidget(std::move(widget3));

    ui_configuration->screen_configurations.push_back(std::move(screen_configuration));

    return ui_configuration;
}

void ui_configuration_parser_CompareUiConfigurations(UiConfiguration& ui_configuration, UiConfiguration& deserialized_ui_configuration) {
    zassert_equal(deserialized_ui_configuration.active_screen_group_id, ui_configuration.active_screen_group_id);

    for(std::size_t i = 0; i < ui_configuration.screen_configurations.size(); i++) {
        zassert_equal(deserialized_ui_configuration.screen_configurations[i]->id, ui_configuration.screen_configurations[i]->id);
        zassert_equal(deserialized_ui_configuration.screen_configurations[i]->screen_group_id, ui_configuration.screen_configurations[i]->screen_group_id);
        zassert_equal(deserialized_ui_configuration.screen_configurations[i]->type, ui_configuration.screen_configurations[i]->type);
        zassert_equal(deserialized_ui_configuration.screen_configurations[i]->z_index, ui_configuration.screen_configurations[i]->z_index);
        zassert_equal(deserialized_ui_configuration.screen_configurations[i]->is_visible, ui_configuration.screen_configurations[i]->is_visible);
        zassert_equal(deserialized_ui_configuration.screen_configurations[i]->is_overlay, ui_configuration.screen_configurations[i]->is_overlay);
        zassert_equal(deserialized_ui_configuration.screen_configurations[i]->grid.snap_enabled, ui_configuration.screen_configurations[i]->grid.snap_enabled);
        zassert_equal(deserialized_ui_configuration.screen_configurations[i]->grid.width, ui_configuration.screen_configurations[i]->grid.width);
        zassert_equal(deserialized_ui_configuration.screen_configurations[i]->grid.height, ui_configuration.screen_configurations[i]->grid.height);
        zassert_equal(deserialized_ui_configuration.screen_configurations[i]->grid.spacing_px, ui_configuration.screen_configurations[i]->grid.spacing_px);

        for(std::size_t j = 0; j < ui_configuration.screen_configurations[i]->widget_configurations.size(); j++) {
            zassert_equal(deserialized_ui_configuration.screen_configurations[i]->widget_configurations[j]->type, ui_configuration.screen_configurations[i]->widget_configurations[j]->type);
            zassert_equal(deserialized_ui_configuration.screen_configurations[i]->widget_configurations[j]->id, ui_configuration.screen_configurations[i]->widget_configurations[j]->id);
            zassert_equal(deserialized_ui_configuration.screen_configurations[i]->widget_configurations[j]->position_grid.x, ui_configuration.screen_configurations[i]->widget_configurations[j]->position_grid.x);
            zassert_equal(deserialized_ui_configuration.screen_configurations[i]->widget_configurations[j]->position_grid.y, ui_configuration.screen_configurations[i]->widget_configurations[j]->position_grid.y);
            zassert_equal(deserialized_ui_configuration.screen_configurations[i]->widget_configurations[j]->size_grid.width, ui_configuration.screen_configurations[i]->widget_configurations[j]->size_grid.width);
            zassert_equal(deserialized_ui_configuration.screen_configurations[i]->widget_configurations[j]->size_grid.height, ui_configuration.screen_configurations[i]->widget_configurations[j]->size_grid.height);
            zassert_equal(deserialized_ui_configuration.screen_configurations[i]->widget_configurations[j]->z_index, ui_configuration.screen_configurations[i]->widget_configurations[j]->z_index);
            zassert_equal(deserialized_ui_configuration.screen_configurations[i]->widget_configurations[j]->properties.size(), ui_configuration.screen_configurations[i]->widget_configurations[j]->properties.size());
            for(auto& property : ui_configuration.screen_configurations[i]->widget_configurations[j]->properties) {
                zassert_true(deserialized_ui_configuration.screen_configurations[i]->widget_configurations[j]->properties[property.first] == ui_configuration.screen_configurations[i]->widget_configurations[j]->properties[property.first]);
            }

            const auto& bindings = ui_configuration.screen_configurations[i]->widget_configurations[j]->bindings;
            const auto& deserialized_bindings = deserialized_ui_configuration.screen_configurations[i]->widget_configurations[j]->bindings;

            zassert_equal(deserialized_bindings.size(), bindings.size());

            for(std::size_t k = 0; k < bindings.size(); k++) {
                zassert_equal(deserialized_bindings[k].target, bindings[k].target);
                zassert_equal(deserialized_bindings[k].channel, bindings[k].channel);
                zassert_equal(deserialized_bindings[k].event_type, bindings[k].event_type);
                zassert_equal(deserialized_bindings[k].payload_key, bindings[k].payload_key);
                zassert_equal(deserialized_bindings[k].direction, bindings[k].direction);
                zassert_equal(deserialized_bindings[k].outbound_event_type, bindings[k].outbound_event_type);
                zassert_equal(deserialized_bindings[k].selector_key, bindings[k].selector_key);
                zassert_equal(deserialized_bindings[k].HasSelector(), bindings[k].HasSelector());
                zassert_true(deserialized_bindings[k].selector_value == bindings[k].selector_value);
            }
        }
    }
}

ZTEST(ui_configuration_parser, test_CborSerializeDeserialize) {
    UiConfigurationCborParser ui_configuration_cbor_parser;

    auto ui_configuration = ui_configuration_parser_GetTestUiConfiguration();

    auto serialized_ui_configuration = ui_configuration_cbor_parser.Serialize(*ui_configuration);
    auto deserialized_ui_configuration = ui_configuration_cbor_parser.Deserialize(Mrm::GetDefaultPmr(), *serialized_ui_configuration.get());

    ui_configuration_parser_CompareUiConfigurations(
        *ui_configuration, *deserialized_ui_configuration);
}

ZTEST(ui_configuration_parser, test_CborRoundTripKeepsBindingDetail) {
    UiConfigurationCborParser parser;

    auto ui_configuration = ui_configuration_parser_GetTestUiConfiguration();
    auto serialized = parser.Serialize(*ui_configuration);
    auto deserialized = parser.Deserialize(Mrm::GetDefaultPmr(), *serialized.get());

    const auto& widgets = deserialized->screen_configurations[0]->widget_configurations;

    const auto& fanned_out = widgets[0]->bindings;
    zassert_equal(fanned_out.size(), 2U);

    // Same source, two targets.
    zassert_equal(fanned_out[0].channel, EventChannelId::Sensors);
    zassert_equal(fanned_out[1].channel, EventChannelId::Sensors);
    zassert_equal(fanned_out[0].payload_key, fanned_out[1].payload_key);
    zassert_not_equal(fanned_out[0].target, fanned_out[1].target);

    zassert_true(fanned_out[0].HasSelector());
    zassert_true(std::get<std::pmr::string>(fanned_out[0].selector_value) == "sensor_1");

    const auto& two_way = widgets[1]->bindings;
    zassert_equal(two_way.size(), 1U);
    zassert_equal(two_way[0].direction, PropertyBindingDirection::InOut);
    zassert_equal(two_way[0].outbound_event_type, 2U);

    // An unset selector must not come back as a decoded value.
    zassert_false(two_way[0].HasSelector());
}

ZTEST(ui_configuration_parser, test_CborRoundTripKeepsAWidgetWithoutBindings) {
    UiConfigurationCborParser parser;

    auto ui_configuration = ui_configuration_parser_GetTestUiConfiguration();
    auto serialized = parser.Serialize(*ui_configuration);
    auto deserialized = parser.Deserialize(Mrm::GetDefaultPmr(), *serialized.get());

    zassert_true(deserialized->screen_configurations[0]->widget_configurations[2]->bindings.empty());
}

// is_visible and is_overlay are adjacent bools on the wire, so only distinct
// values catch a field shift between them.
ZTEST(ui_configuration_parser, test_CborRoundTripKeepsOverlayApartFromVisibility) {
    UiConfigurationCborParser parser;

    auto ui_configuration = ui_configuration_parser_GetTestUiConfiguration();
    auto& screen = *ui_configuration->screen_configurations[0];
    screen.is_visible = false;
    screen.is_overlay = true;

    auto serialized = parser.Serialize(*ui_configuration);

    zassert_false(serialized->CborScreenConfig_m[0].is_visible);
    zassert_true(serialized->CborScreenConfig_m[0].is_overlay);

    auto deserialized = parser.Deserialize(Mrm::GetDefaultPmr(), *serialized.get());

    zassert_false(deserialized->screen_configurations[0]->is_visible);
    zassert_true(deserialized->screen_configurations[0]->is_overlay);
}

ZTEST(ui_configuration_parser, test_AScreenIsNotAnOverlayByDefault) {
    auto screen_configuration = make_shared_pmr<ScreenConfiguration>(Mrm::GetDefaultPmr());

    zassert_false(screen_configuration->is_overlay);
}

ZTEST(ui_configuration_parser, test_CborSerializeStampsTheCurrentVersion) {
    UiConfigurationCborParser parser;

    auto ui_configuration = ui_configuration_parser_GetTestUiConfiguration();
    auto serialized = parser.Serialize(*ui_configuration);

    zassert_equal(serialized->version, UiConfigurationCborParser::configuration_version);
}

ZTEST(ui_configuration_parser, test_CborDeserializeRejectsAnotherVersion) {
    UiConfigurationCborParser parser;

    auto ui_configuration = ui_configuration_parser_GetTestUiConfiguration();
    auto serialized = parser.Serialize(*ui_configuration);

    serialized->version = UiConfigurationCborParser::configuration_version - 1;

    bool threw = false;

    try {
        parser.Deserialize(Mrm::GetDefaultPmr(), *serialized.get());
    } catch(const std::invalid_argument&) {
        threw = true;
    }

    zassert_true(threw);
}

ZTEST(ui_configuration_parser, test_CborDeserializeOrdersWidgetsByZIndex) {
    UiConfigurationCborParser ui_configuration_cbor_parser;

    auto ui_configuration = ui_configuration_parser_GetTestUiConfiguration();
    auto& widget_configurations = ui_configuration->screen_configurations[0]->widget_configurations;
    widget_configurations[0]->z_index = 5;
    widget_configurations[1]->z_index = 1;
    widget_configurations[2]->z_index = 1;

    auto serialized_ui_configuration = ui_configuration_cbor_parser.Serialize(*ui_configuration);
    auto deserialized_ui_configuration = ui_configuration_cbor_parser.Deserialize(Mrm::GetDefaultPmr(), *serialized_ui_configuration.get());

    auto& deserialized_widget_configurations = deserialized_ui_configuration->screen_configurations[0]->widget_configurations;
    zassert_equal(deserialized_widget_configurations.size(), widget_configurations.size());

    // Equal z-index keeps configuration order.
    zassert_equal(deserialized_widget_configurations[0]->id, widget_configurations[1]->id);
    zassert_equal(deserialized_widget_configurations[1]->id, widget_configurations[2]->id);
    zassert_equal(deserialized_widget_configurations[2]->id, widget_configurations[0]->id);
}
```

## src/ui_configuration_validator.cpp
```c
#include <array>
#include <memory>
#include <stdexcept>
#include <utility>

#include <zephyr/ztest.h>
#include <eerie_memory.hpp>

#include "utilities/memory/memory_resource_manager.h"

#include "domain/ui_domain/models/ui_configuration.h"
#include "domain/ui_domain/models/widget_type.h"
#include "domain/ui_domain/models/widget_property.h"
#include "domain/ui_domain/models/property_binding.h"
#include "domain/ui_domain/configuration/parsers/ui_configuration_validator.h"

using namespace eerie_memory;
using namespace eerie_leap::utilities::memory;
using namespace eerie_leap::domain::ui_domain::models;
using namespace eerie_leap::domain::ui_domain::configuration::parsers;

ZTEST_SUITE(ui_configuration_validator, NULL, NULL, NULL, NULL, NULL);

namespace {

std::shared_ptr<WidgetConfiguration> MakeWidget(uint32_t id) {
    auto widget_configuration = make_shared_pmr<WidgetConfiguration>(Mrm::GetDefaultPmr());
    widget_configuration->type = WidgetType::IndicatorDigital;
    widget_configuration->id = id;
    widget_configuration->position_grid.x = 0;
    widget_configuration->position_grid.y = 0;
    widget_configuration->size_grid.width = 3;
    widget_configuration->size_grid.height = 3;

    return widget_configuration;
}

std::shared_ptr<ScreenConfiguration> MakeScreen(uint32_t id, uint32_t screen_group_id) {
    auto screen_configuration = make_shared_pmr<ScreenConfiguration>(Mrm::GetDefaultPmr());
    screen_configuration->id = id;
    screen_configuration->screen_group_id = screen_group_id;
    screen_configuration->type = ScreenType::Gauge;
    screen_configuration->grid.snap_enabled = true;
    screen_configuration->grid.width = 3;
    screen_configuration->grid.height = 3;
    screen_configuration->grid.spacing_px = 0;

    screen_configuration->AddWidget(MakeWidget(0));

    return screen_configuration;
}

pmr_unique_ptr<UiConfiguration> MakeConfiguration() {
    auto configuration = make_unique_pmr<UiConfiguration>(Mrm::GetDefaultPmr());
    configuration->active_screen_group_id = 1;
    configuration->screen_configurations.push_back(MakeScreen(0, 1));

    return configuration;
}

bool Validates(const UiConfiguration& configuration) {
    try {
        UiConfigurationValidator::Validate(configuration);
    } catch(const std::invalid_argument&) {
        return false;
    }

    return true;
}

PropertyBinding MakeSensorBinding() {
    PropertyBinding binding;
    binding.target = WidgetPropertyType::VALUE;
    binding.channel = EventChannelId::Sensors;
    binding.event_type = 0;
    binding.payload_key = 1;
    binding.selector_key = 0;
    binding.selector_value = std::pmr::string("sensor_1");

    return binding;
}

void AddBinding(UiConfiguration& configuration, PropertyBinding binding) {
    configuration.screen_configurations[0]->widget_configurations[0]->bindings.push_back(std::move(binding));
}

} // namespace

ZTEST(ui_configuration_validator, test_valid_configuration) {
    zassert_true(Validates(*MakeConfiguration()));
}

ZTEST(ui_configuration_validator, test_empty_configuration_is_valid) {
    // The default configuration created on first boot has no screens.
    auto configuration = make_unique_pmr<UiConfiguration>(Mrm::GetDefaultPmr());

    zassert_true(Validates(*configuration));
}

ZTEST(ui_configuration_validator, test_the_screen_count_limit_matches_the_schema) {
    auto configuration = MakeConfiguration();

    // MakeConfiguration() already holds one, so this fills the schema's 24 slots.
    for(uint32_t i = 1; i < 24; i++)
        configuration->screen_configurations.push_back(MakeScreen(i, 1));

    zassert_true(Validates(*configuration));
}

ZTEST(ui_configuration_validator, test_too_many_screens_is_invalid) {
    auto configuration = MakeConfiguration();

    for(uint32_t i = 1; i <= 24; i++)
        configuration->screen_configurations.push_back(MakeScreen(i, 1));

    zassert_false(Validates(*configuration));
}

ZTEST(ui_configuration_validator, test_duplicate_screen_id_is_invalid) {
    auto configuration = MakeConfiguration();
    configuration->screen_configurations.push_back(MakeScreen(0, 1));

    zassert_false(Validates(*configuration));
}

ZTEST(ui_configuration_validator, test_unknown_screen_type_is_invalid) {
    auto configuration = MakeConfiguration();
    configuration->screen_configurations[0]->type = ScreenType::None;

    zassert_false(Validates(*configuration));
}

ZTEST(ui_configuration_validator, test_empty_grid_is_invalid) {
    auto configuration = MakeConfiguration();
    configuration->screen_configurations[0]->grid.width = 0;

    zassert_false(Validates(*configuration));
}

ZTEST(ui_configuration_validator, test_active_screen_group_without_screen_is_invalid) {
    auto configuration = MakeConfiguration();
    configuration->active_screen_group_id = 7;

    zassert_false(Validates(*configuration));
}

ZTEST(ui_configuration_validator, test_duplicate_widget_id_is_invalid) {
    auto configuration = MakeConfiguration();
    configuration->screen_configurations[0]->AddWidget(MakeWidget(0));

    zassert_false(Validates(*configuration));
}

ZTEST(ui_configuration_validator, test_unknown_widget_type_is_invalid) {
    auto configuration = MakeConfiguration();
    configuration->screen_configurations[0]->widget_configurations[0]->type = WidgetType::None;

    zassert_false(Validates(*configuration));
}

ZTEST(ui_configuration_validator, test_empty_widget_size_is_invalid) {
    auto configuration = MakeConfiguration();
    configuration->screen_configurations[0]->widget_configurations[0]->size_grid.height = 0;

    zassert_false(Validates(*configuration));
}

ZTEST(ui_configuration_validator, test_widget_larger_than_grid_is_invalid) {
    auto configuration = MakeConfiguration();
    configuration->screen_configurations[0]->widget_configurations[0]->size_grid.width = 4;

    zassert_false(Validates(*configuration));
}

ZTEST(ui_configuration_validator, test_negative_widget_position_is_invalid) {
    auto configuration = MakeConfiguration();
    configuration->screen_configurations[0]->widget_configurations[0]->position_grid.y = -1;

    zassert_false(Validates(*configuration));
}

ZTEST(ui_configuration_validator, test_widget_position_outside_grid_is_invalid) {
    auto configuration = MakeConfiguration();
    configuration->screen_configurations[0]->widget_configurations[0]->position_grid.x = 3;

    zassert_false(Validates(*configuration));
}

ZTEST(ui_configuration_validator, test_known_widget_properties_are_valid) {
    auto configuration = MakeConfiguration();
    auto& properties = configuration->screen_configurations[0]->widget_configurations[0]->properties;

    properties[WidgetProperty::GetTypeName(WidgetPropertyType::LABEL)] = "sensor_1";
    properties[WidgetProperty::GetTypeName(WidgetPropertyType::IS_SMOOTHED)] = true;
    properties[WidgetProperty::GetTypeName(WidgetPropertyType::MIN_VALUE)] = 0;
    properties[WidgetProperty::GetTypeName(WidgetPropertyType::MAX_VALUE)] = 100.5;

    zassert_true(Validates(*configuration));
}

ZTEST(ui_configuration_validator, test_unknown_widget_property_is_invalid) {
    auto configuration = MakeConfiguration();
    configuration->screen_configurations[0]->widget_configurations[0]->properties["NOT_A_PROPERTY"] = 1;

    zassert_false(Validates(*configuration));
}

ZTEST(ui_configuration_validator, test_widget_property_with_wrong_value_type_is_invalid) {
    auto configuration = MakeConfiguration();
    auto& properties = configuration->screen_configurations[0]->widget_configurations[0]->properties;

    properties[WidgetProperty::GetTypeName(WidgetPropertyType::MIN_VALUE)] = true;

    zassert_false(Validates(*configuration));
}

ZTEST(ui_configuration_validator, test_widget_property_without_value_is_invalid) {
    auto configuration = MakeConfiguration();
    auto& properties = configuration->screen_configurations[0]->widget_configurations[0]->properties;

    properties[WidgetProperty::GetTypeName(WidgetPropertyType::LABEL)] = ConfigValue{};

    zassert_false(Validates(*configuration));
}

ZTEST(ui_configuration_validator, test_settings_screen_type_is_valid) {
    auto configuration = MakeConfiguration();
    configuration->screen_configurations[0]->type = ScreenType::Settings;

    zassert_true(Validates(*configuration));
}

ZTEST(ui_configuration_validator, test_popup_screen_type_is_valid) {
    auto configuration = MakeConfiguration();
    configuration->screen_configurations[0]->type = ScreenType::Popup;

    zassert_true(Validates(*configuration));
}

ZTEST(ui_configuration_validator, test_control_widget_types_are_valid) {
    constexpr std::array control_types = {
        WidgetType::ControlSlider,
        WidgetType::ControlToggle,
        WidgetType::ControlButton,
        WidgetType::IndicatorSetting
    };

    for(auto control_type : control_types) {
        auto configuration = MakeConfiguration();
        configuration->screen_configurations[0]->widget_configurations[0]->type = control_type;

        zassert_true(Validates(*configuration), "Expected widget type %u to be accepted.", static_cast<uint32_t>(control_type));
    }
}

ZTEST(ui_configuration_validator, test_control_widget_properties_are_valid) {
    auto configuration = MakeConfiguration();
    auto& widget_configuration = configuration->screen_configurations[0]->widget_configurations[0];
    widget_configuration->type = WidgetType::ControlSlider;

    auto& properties = widget_configuration->properties;
    properties[WidgetProperty::GetTypeName(WidgetPropertyType::SETTING_ID)] = "display.brightness";
    properties[WidgetProperty::GetTypeName(WidgetPropertyType::UNIT)] = "%";
    properties[WidgetProperty::GetTypeName(WidgetPropertyType::STEP)] = 5.0;
    properties[WidgetProperty::GetTypeName(WidgetPropertyType::TARGET_SCREEN_GROUP)] = 2;

    zassert_true(Validates(*configuration));
}

ZTEST(ui_configuration_validator, test_numeric_setting_id_is_invalid) {
    auto configuration = MakeConfiguration();
    auto& properties = configuration->screen_configurations[0]->widget_configurations[0]->properties;

    properties[WidgetProperty::GetTypeName(WidgetPropertyType::SETTING_ID)] = 1;

    zassert_false(Validates(*configuration));
}

ZTEST(ui_configuration_validator, test_a_widget_without_bindings_is_valid) {
    auto configuration = MakeConfiguration();

    zassert_true(configuration->screen_configurations[0]->widget_configurations[0]->bindings.empty());
    zassert_true(Validates(*configuration));
}

ZTEST(ui_configuration_validator, test_a_sensor_binding_is_valid) {
    auto configuration = MakeConfiguration();

    AddBinding(*configuration, MakeSensorBinding());

    zassert_true(Validates(*configuration));
}

ZTEST(ui_configuration_validator, test_an_unconditional_binding_is_valid) {
    auto configuration = MakeConfiguration();

    auto binding = MakeSensorBinding();
    binding.selector_key = 0;
    binding.selector_value = { };

    zassert_false(binding.HasSelector());

    AddBinding(*configuration, std::move(binding));

    zassert_true(Validates(*configuration));
}

ZTEST(ui_configuration_validator, test_several_bindings_may_share_one_source) {
    auto configuration = MakeConfiguration();

    auto first = MakeSensorBinding();
    auto second = MakeSensorBinding();
    second.target = WidgetPropertyType::IS_VISIBLE;

    AddBinding(*configuration, std::move(first));
    AddBinding(*configuration, std::move(second));

    zassert_true(Validates(*configuration));
}

ZTEST(ui_configuration_validator, test_a_binding_without_a_channel_is_invalid) {
    auto configuration = MakeConfiguration();

    auto binding = MakeSensorBinding();
    binding.channel = EventChannelId::None;

    AddBinding(*configuration, std::move(binding));

    zassert_false(Validates(*configuration));
}

ZTEST(ui_configuration_validator, test_an_unknown_channel_is_invalid) {
    auto configuration = MakeConfiguration();

    auto binding = MakeSensorBinding();
    binding.channel = static_cast<EventChannelId>(99);

    AddBinding(*configuration, std::move(binding));

    zassert_false(Validates(*configuration));
}

ZTEST(ui_configuration_validator, test_an_unknown_direction_is_invalid) {
    auto configuration = MakeConfiguration();

    auto binding = MakeSensorBinding();
    binding.direction = static_cast<PropertyBindingDirection>(99);

    AddBinding(*configuration, std::move(binding));

    zassert_false(Validates(*configuration));
}

ZTEST(ui_configuration_validator, test_a_binding_without_a_target_is_invalid) {
    auto configuration = MakeConfiguration();

    auto binding = MakeSensorBinding();
    binding.target = WidgetPropertyType::NONE;

    AddBinding(*configuration, std::move(binding));

    zassert_false(Validates(*configuration));
}

ZTEST(ui_configuration_validator, test_an_unknown_target_property_is_invalid) {
    auto configuration = MakeConfiguration();

    auto binding = MakeSensorBinding();
    binding.target = static_cast<WidgetPropertyType>(9999);

    AddBinding(*configuration, std::move(binding));

    zassert_false(Validates(*configuration));
}

ZTEST(ui_configuration_validator, test_an_integer_selector_is_valid) {
    auto configuration = MakeConfiguration();

    auto binding = MakeSensorBinding();
    binding.selector_value = 42;

    AddBinding(*configuration, std::move(binding));

    zassert_true(Validates(*configuration));
}

ZTEST(ui_configuration_validator, test_a_selector_that_cannot_be_compared_is_invalid) {
    auto configuration = MakeConfiguration();

    // A selector is matched against a uint32 in the payload; a bool cannot reduce to one.
    auto binding = MakeSensorBinding();
    binding.selector_value = true;

    AddBinding(*configuration, std::move(binding));

    zassert_false(Validates(*configuration));
}
```

## src/widget_property.cpp
```c
#include <array>
#include <stdexcept>
#include <string_view>

#include <zephyr/ztest.h>

#include "domain/ui_domain/models/widget_property.h"

using namespace eerie_leap::domain::ui_domain::models;

ZTEST_SUITE(widget_property, NULL, NULL, NULL, NULL, NULL);

namespace {

constexpr std::array all_types = {
    WidgetPropertyType::NONE,
    WidgetPropertyType::IS_ACTIVE,
    WidgetPropertyType::IS_SMOOTHED,
    WidgetPropertyType::MIN_VALUE,
    WidgetPropertyType::MAX_VALUE,
    WidgetPropertyType::CHART_POINT_COUNT,
    WidgetPropertyType::CHART_TYPE,
    WidgetPropertyType::LABEL,
    WidgetPropertyType::VALUE_PRECISION,
    WidgetPropertyType::EDGE_OFFSET,
    WidgetPropertyType::POSITION_X,
    WidgetPropertyType::POSITION_Y,
    WidgetPropertyType::POSITION_ANGLE,
    WidgetPropertyType::ICON_TYPE,
    WidgetPropertyType::START_ANGLE,
    WidgetPropertyType::END_ANGLE,
    WidgetPropertyType::FILE_PATH,
    WidgetPropertyType::IMG_WIDTH,
    WidgetPropertyType::IMG_HEIGHT,
    WidgetPropertyType::PIVOT_X,
    WidgetPropertyType::PIVOT_Y,
    WidgetPropertyType::DIRECTION,
    WidgetPropertyType::SETTING_ID,
    WidgetPropertyType::STEP,
    WidgetPropertyType::UNIT,
    WidgetPropertyType::TARGET_SCREEN_GROUP,
    WidgetPropertyType::IS_VISIBLE,
    WidgetPropertyType::VALUE,
    WidgetPropertyType::NAVIGATION_INTENT
};

} // namespace

// The enum and the name table are positional; a name added out of order silently
// re-keys every persisted property after it.
ZTEST(widget_property, test_every_type_round_trips_through_its_name) {
    for(auto type : all_types)
        zassert_equal(
            WidgetProperty::GetType(WidgetProperty::GetTypeName(type)),
            type,
            "Property type %u does not round trip.", static_cast<unsigned>(type));
}

ZTEST(widget_property, test_phase_four_names) {
    zassert_equal(std::string_view(WidgetProperty::GetTypeName(WidgetPropertyType::SETTING_ID)), "SETTING_ID");
    zassert_equal(std::string_view(WidgetProperty::GetTypeName(WidgetPropertyType::STEP)), "STEP");
    zassert_equal(std::string_view(WidgetProperty::GetTypeName(WidgetPropertyType::UNIT)), "UNIT");
    zassert_equal(std::string_view(WidgetProperty::GetTypeName(WidgetPropertyType::TARGET_SCREEN_GROUP)), "TARGET_SCREEN_GROUP");
}

ZTEST(widget_property, test_unknown_name_is_rejected) {
    bool threw = false;

    try {
        WidgetProperty::GetType("NOT_A_PROPERTY");
    } catch(const std::runtime_error&) {
        threw = true;
    }

    zassert_true(threw);
}

ZTEST(widget_property, test_out_of_range_type_is_rejected) {
    bool threw = false;

    try {
        WidgetProperty::GetTypeName(static_cast<WidgetPropertyType>(all_types.size()));
    } catch(const std::runtime_error&) {
        threw = true;
    }

    zassert_true(threw);
}
```

## src/widget_type.cpp
```c
#include <array>
#include <cstdint>

#include <zephyr/ztest.h>

#include "domain/ui_domain/models/widget_type.h"

using namespace eerie_leap::domain::ui_domain::models;

ZTEST_SUITE(widget_type, NULL, NULL, NULL, NULL, NULL);

ZTEST(widget_type, test_category_is_resolved_per_type) {
    zassert_equal(WidgetTypeHelpers::GetCategory(WidgetType::BasicIcon), WidgetCategory::Basic);
    zassert_equal(WidgetTypeHelpers::GetCategory(WidgetType::IndicatorDial), WidgetCategory::Indicator);
    zassert_equal(WidgetTypeHelpers::GetCategory(WidgetType::ControlSlider), WidgetCategory::Control);
    zassert_equal(WidgetTypeHelpers::GetCategory(WidgetType::None), WidgetCategory::None);
}

// It renders a setting read-only and drives nothing, so it must not be grouped
// with the widgets that write one.
ZTEST(widget_type, test_setting_backed_display_is_an_indicator) {
    zassert_equal(WidgetTypeHelpers::GetCategory(WidgetType::IndicatorSetting), WidgetCategory::Indicator);
    zassert_false(WidgetTypeHelpers::IsCategory(WidgetType::IndicatorSetting, WidgetCategory::Control));
}

// Control (3 << 16) shares bits with Basic (1 << 16) and Indicator (2 << 16), so
// a plain bitwise AND reports a control widget as being in either of them.
ZTEST(widget_type, test_control_type_is_not_reported_as_another_category) {
    zassert_true(WidgetTypeHelpers::IsCategory(WidgetType::ControlSlider, WidgetCategory::Control));
    zassert_false(WidgetTypeHelpers::IsCategory(WidgetType::ControlSlider, WidgetCategory::Basic));
    zassert_false(WidgetTypeHelpers::IsCategory(WidgetType::ControlSlider, WidgetCategory::Indicator));
}

ZTEST(widget_type, test_indicator_type_is_not_reported_as_basic) {
    zassert_true(WidgetTypeHelpers::IsCategory(WidgetType::IndicatorBar, WidgetCategory::Indicator));
    zassert_false(WidgetTypeHelpers::IsCategory(WidgetType::IndicatorBar, WidgetCategory::Basic));
    zassert_false(WidgetTypeHelpers::IsCategory(WidgetType::IndicatorBar, WidgetCategory::Control));
}

ZTEST(widget_type, test_types_are_unique) {
    constexpr std::array types = {
        WidgetType::BasicIcon,
        WidgetType::BasicArcIcon,
        WidgetType::IndicatorArcFill,
        WidgetType::IndicatorDigital,
        WidgetType::IndicatorHorizontalChart,
        WidgetType::IndicatorSegmentArc,
        WidgetType::IndicatorDial,
        WidgetType::IndicatorBar,
        WidgetType::IndicatorSetting,
        WidgetType::ControlSlider,
        WidgetType::ControlToggle,
        WidgetType::ControlButton
    };

    for(size_t i = 0; i < types.size(); i++)
        for(size_t j = i + 1; j < types.size(); j++)
            zassert_not_equal(
                static_cast<uint32_t>(types[i]),
                static_cast<uint32_t>(types[j]),
                "Widget types at %zu and %zu collide.", i, j);
}
```
