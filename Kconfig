## boards/waveshare/esp32s3_touch_amoled_1_75/Kconfig
```kconfig
# Copyright (c) 2024 Joel Guittet
# SPDX-License-Identifier: Apache-2.0

config HEAP_MEM_POOL_ADD_SIZE_BOARD
	int
	default 4096 if BOARD_ESP32S3_TOUCH_AMOLED_1_75_ESP32S3_PROCPU
	default 256 if BOARD_ESP32S3_TOUCH_AMOLED_1_75_ESP32S3_APPCPU
```

## boards/waveshare/esp32s3_touch_amoled_1_75/Kconfig.defconfig
```kconfig
# Copyright (c) 2024 Joel Guittet
# SPDX-License-Identifier: Apache-2.0

if BOARD_ESP32S3_TOUCH_AMOLED_1_75_ESP32S3_PROCPU

config KERNEL_MEM_POOL
	default y

config PWM
	default y if DISPLAY

configdefault LV_COLOR_16_SWAP
	default y if LVGL

endif # BOARD_ESP32S3_TOUCH_AMOLED_1_75_ESP32S3_PROCPU
```

## boards/waveshare/esp32s3_touch_amoled_1_75/board.yml
```yaml
board:
  name: esp32s3_touch_amoled_1_75
  full_name: ESP32-S3-Touch-AMOLED-1.75
  vendor: waveshare
  socs:
  - name: esp32s3
```

## boards/waveshare/esp32s3_touch_amoled_1_75/esp32s3_touch_amoled_1_75_esp32s3_procpu_defconfig
```kconfig
# Copyright (c) 2024 Joel Guittet
# SPDX-License-Identifier: Apache-2.0

CONFIG_GPIO=y
CONFIG_DMA=y
CONFIG_REGULATOR=y
CONFIG_CONSOLE=y
CONFIG_SERIAL=y
CONFIG_UART_CONSOLE=y
CONFIG_CLOCK_CONTROL=y
CONFIG_INPUT=y
CONFIG_INPUT_CST92XX_INTERRUPT=n

CONFIG_MSPI_DMA_MAX_BUFFER_SIZE=12276
```

## drivers/Kconfig
```kconfig
menu "Drivers"
rsource "mspi/Kconfig.esp32"
rsource "display/Kconfig.elco5300"
rsource "input/Kconfig.cst92xx"
endmenu
```

## drivers/display/Kconfig.co5300
```kconfig
# Copyright (c) 2024
# SPDX-License-Identifier: Apache-2.0

# CO5300 QSPI Display Controller Configuration

config CO5300
	bool "CO5300 QSPI Display Controller"
	default y
	depends on DT_HAS_CHIPONE_CO5300_ENABLED
	help
	  Enable support for the CO5300 QSPI display controller.
```

## drivers/display/Kconfig.elco5300
```kconfig
# Copyright 2025 Pavel Maloletkov.
# SPDX-License-Identifier: Apache-2.0

# CO5300 QSPI Display Controller Configuration

config ELCO5300
	bool "CO5300 QSPI Display Controller"
	default y
	depends on DT_HAS_CHIPONE_ELCO5300_ENABLED
	help
	  Enable support for the CO5300 QSPI display controller.
```

## drivers/input/Kconfig
```kconfig
# Copyright (c) 2025 Pavel Maloletkov.
# SPDX-License-Identifier: Apache-2.0

if INPUT

menu "Input drivers"

# zephyr-keep-sorted-start
source "drivers/input/Kconfig.cst92xx"
# zephyr-keep-sorted-stop

endmenu # Input Drivers

endif # INPUT
```

## drivers/input/Kconfig.cst92xx
```kconfig
# Copyright 2025 Pavel Maloletkov.
# SPDX-License-Identifier: Apache-2.0

menuconfig INPUT_CST92XX
	bool "CST92XX capacitive touch panel driver"
	default y
	depends on DT_HAS_HYNITRON_CST92XX_ENABLED
	select I2C
	help
	  Enable driver for hynitron cst816s touch panel.

if INPUT_CST92XX

config INPUT_CST92XX_PERIOD
	int "Sample period"
	depends on !INPUT_CST92XX_INTERRUPT
	default 20
	help
	  Sample period in milliseconds when in polling mode.

config INPUT_CST92XX_INTERRUPT
	bool "Interrupt support"
	default y
	depends on GPIO
	help
	  Enable interrupt support (requires GPIO).

config INPUT_CST92XX_EV_DEVICE
	bool "Device specific event support"
	help
	  Enable device specific event support.

endif # INPUT_CST92XX
```

## dts/bindings/display/chipone,co5300.yaml
```yaml
# Copyright (c) 2024 OSPTEK Co., Ltd.
# SPDX-License-Identifier: Apache-2.0

description: CO5300 QSPI Display Controller

compatible: "chipone,co5300"

include: [mspi-device.yaml, display-controller.yaml, lcd-controller.yaml, pinctrl-device.yaml]

properties:
  te-gpios:
    type: phandle-array
    description: |
      Tearing effect GPIO pin.

  reset-gpios:
    type: phandle-array
    description: |
      Reset GPIO pin. Set high to reset the display

  write-only:
    type: boolean
    description: |
      Only writes to display controller, do not perform reads.
      If all controllers are write-only, read functions will be
      optimized out for size.
      It can also be used as an alternative to half duplex when
      only one data line is connected.

  orientation:
    type: string
    default: "normal"
    enum:
      - "normal"
      - "90"
      - "180"
      - "270"
    description: Display orientation (CW) in degrees.

  display-invert:
    type: boolean
    description: |
      Display inversion mode. Every bit is inverted from the frame memory to
      the display.

  color-invert:
    type: boolean
    description: |
      Enable color inversion.

  sram-size:
    type: int
    default: 230400
    description: |
      Total SRAM size in bytes. CO5300 has 230.4KB (230400 bytes) of internal SRAM.

  max-buf-size:
    type: int
    default: 4092
    description: |
      Maximum number of pixels that are sent in one transfer.
      Valid range is [8, 12276].
```

## dts/bindings/input/hynitron,cst92xx.yaml
```yaml
# Copyright (c) 2025 Pavel Maloletkov
# SPDX-License-Identifier: Apache-2.0

description: Hynitron CST92xx touchscreen sensor

compatible: "hynitron,cst92xx"

include: i2c-device.yaml

properties:
  irq-gpios:
    type: phandle-array
    description: |
      The irq signal defaults to active low as produced by the
      sensor. The property value should ensure the flags properly
      describe the signal that is presented to the driver.

  rst-gpios:
    type: phandle-array
    description: |
      The reset signal defaults to active low to the
      sensor. The property value should ensure the flags properly
      describe the signal that is presented to the driver.
```

## tests/functional/configuration/testcase.yaml
```yaml
common:
  tags: configuration
  platform_allow:
    - native_sim

tests:
  functional.configuration: {}
```
